## board/full-v/zylaser/image.its
```
/dts-v1/;

/ {
        description = "U-Boot fitImage for Zylaser";
        #address-cells = <1>;

        images {
                kernel-1 {
                        description = "Linux kernel";
                        data = /incbin/("zImage");
                        type = "kernel";
                        arch = "arm";
                        os = "linux";
                        compression = "none";
                        load = <0x200000>;
                        entry = <0x200000>;
                        hash-1 {
                                algo = "sha256";
                        };
                };
                fdt-system-top.dtb {
                        description = "Flattened Device Tree blob";
                        data = /incbin/("devicetree.dtb");
                        type = "flat_dt";
                        arch = "arm";
                        compression = "none";
                        hash-1 {
                                algo = "sha256";
                        };
                };
                ramdisk-1 {
                        description = "rootfs";
                        data = /incbin/("rootfs.cpio.gz");
                        type = "ramdisk";
                        arch = "arm";
                        os = "linux";
                        compression = "none";
                        hash-1 {
                                algo = "sha256";
                        };
                };
	};

        configurations {
                default = "noramdisk";

                ramdisk {
			description = "1 Linux kernel, FDT blob, ramdisk";
			kernel = "kernel-1";
			fdt = "fdt-system-top.dtb";
			ramdisk = "ramdisk-1";
                        hash-1 {
                                algo = "sha256";
                        };
                };

                noramdisk {
			description = "1 Linux kernel, FDT blob";
			kernel = "kernel-1";
			fdt = "fdt-system-top.dtb";
                        hash-1 {
                                algo = "sha256";
                        };
                };
	};
};
```

## board/tdc/jycz2s/boot-mfg.its
```
/dts-v1/;

/ {
    description = "U-Boot fitImage for JYCZ2S";
    #address-cells = <1>;

    images {
        kernel-1 {
            description = "Linux Kernel";
            data = /incbin/("zImage");
            type = "kernel";
            arch = "arm";
            os = "linux";
            compression = "none";
            load = <0x10008000>;
            entry = <0x10008000>;
            hash-1 {
                algo = "sha1";
            };
        };

        ramdisk-1 {
            description = "Rootfs Ramdisk";
            data = /incbin/("initrd.cpio.gz");
            type = "ramdisk";
            arch = "arm";
            os = "linux";
            compression = "none";
            hash-1 {
                algo = "sha1";
            };
        };

        fdt-1 {
            description = "Flattened Device Tree blob";
            data = /incbin/("imx6q-jycz2s.dtb");
            type = "flat_dt";
            arch = "arm";
            compression = "none";
            hash-1 {
                algo = "sha1";
            };
        };
    };

    configurations {
        default = "ramdisk";
        ramdisk {
            description = "Boot Linux kernel with FDT blob + ramdisk";
            kernel = "kernel-1";
            ramdisk = "ramdisk-1";
            fdt = "fdt-1";
            hash-1 {
                algo = "sha1";
            };
        };
        noramdisk {
            description = "Boot Linux kernel with FDT blob";
            kernel = "kernel-1";
            fdt = "fdt-1";
            hash-1 {
                algo = "sha1";
            };
        };
    };
};
```

## board/tdc/mpcam-v1/image.its
```
/dts-v1/;

/ {
    description = "U-Boot fitImage for MPCAM-V1";
    #address-cells = <1>;

    images {
        kernel-1 {
            description = "Linux Kernel";
            data = /incbin/("zImage");
            type = "kernel";
            arch = "arm";
            os = "linux";
            compression = "none";
            load = <0x8000>;
            entry = <0x8000>;
            hash-1 {
                algo = "sha1";
            };
        };

        ramdisk-1 {
            description = "Rootfs Ramdisk";
            data = /incbin/("rootfs.cpio.lz4");
            type = "ramdisk";
            arch = "arm";
            os = "linux";
            compression = "none";
            hash-1 {
                algo = "sha1";
            };
        };

        fdt-1 {
            description = "Flattened Device Tree blob";
            data = /incbin/("zynq-mpcam-v1.dtb");
            type = "flat_dt";
            arch = "arm";
            compression = "none";
            hash-1 {
                algo = "sha1";
            };
        };
    };

    configurations {
        default = "ramdisk";
        ramdisk {
            description = "Boot Linux kernel with FDT blob + ramdisk";
            kernel = "kernel-1";
            ramdisk = "ramdisk-1";
            fdt = "fdt-1";
            hash-1 {
                algo = "sha1";
            };
        };
        noramdisk {
            description = "Boot Linux kernel with FDT blob";
            kernel = "kernel-1";
            fdt = "fdt-1";
            hash-1 {
                algo = "sha1";
            };
        };
    };
};
```

## boot/arm-trusted-firmware-hisi/Config.in
```kconfig
config BR2_TARGET_ARM_TRUSTED_FIRMWARE_HISI
	bool "arm-trusted-firmware (hisillicon)"
	help
	  ARM Trusted Firmware provides a reference implementation of secure world
	  software for [ARMv8-A], including a [Secure Monitor] [TEE-SMC] executing at
	  Exception Level 3 (EL3). It implements various ARM interface standards, such as
	  the Power State Coordination Interface ([PSCI]), Trusted Board Boot Requirements
	  (TBBR, ARM DEN0006C-1) and [SMC Calling Convention][SMCCC]. As far as possible
	  the code is designed for reuse or porting to other ARMv8-A model and hardware
	  platforms.

if BR2_TARGET_ARM_TRUSTED_FIRMWARE_HISI

choice
        prompt "Chipset"

config BR2_TARGET_ARM_TRUSTED_FIRMWARE_HISI_CHIP_HI3559AV100
	bool "hi3559av100"

endchoice

config BR2_TARGET_ARM_TRUSTED_FIRMWARE_HISI_CHIP
	string
	default "hi3559av100" if BR2_TARGET_ARM_TRUSTED_FIRMWARE_HISI_CHIP_HI3559AV100

choice
        prompt "CPU Type"

config BR2_TARGET_ARM_TRUSTED_FIRMWARE_HISI_CPU_TYPE_BIG_LITTLE
	bool "big-little"

config BR2_TARGET_ARM_TRUSTED_FIRMWARE_HISI_CPU_TYPE_MULTI_CORE
	bool "multi-core"

endchoice

config BR2_TARGET_ARM_TRUSTED_FIRMWARE_HISI_CPU_TYPE
	string
	default "big-little" if BR2_TARGET_ARM_TRUSTED_FIRMWARE_HISI_CPU_TYPE_BIG_LITTLE
	default "multi-core" if BR2_TARGET_ARM_TRUSTED_FIRMWARE_HISI_CPU_TYPE_MULTI_CORE

endif
```

## boot/zynq-fsbl/Config.in
```kconfig
config BR2_TARGET_ZYNQ_FSBL
	bool "zynq-fsbl"
	help
	  First stage boot loader for Zynq-7000 Devices.

if BR2_TARGET_ZYNQ_FSBL

choice
	prompt "Zynq FSBL Version"
	help
	  Select the specific Zynq FSBL version you want to use

config BR2_TARGET_ZYNQ_FSBL_LATEST_VERSION
	bool "Latest version"

config BR2_TARGET_ZYNQ_FSBL_CUSTOM_VERSION
	bool "Custom version"
	help
	  This option allows to use a specific official versions

config BR2_TARGET_ZYNQ_FSBL_CUSTOM_TARBALL
	bool "Custom tarball"

endchoice

config BR2_TARGET_ZYNQ_FSBL_CUSTOM_VERSION_VALUE
	string "Zynq FSBL version"
	depends on BR2_TARGET_ZYNQ_FSBL_CUSTOM_VERSION

config BR2_TARGET_ZYNQ_FSBL_CUSTOM_TARBALL_LOCATION
	string "URL of custom Zynq FSBL tarball"
	depends on BR2_TARGET_ZYNQ_FSBL_CUSTOM_TARBALL

config BR2_TARGET_ZYNQ_FSBL_VERSION
	string
	default "xilinx-v2020.1" if BR2_TARGET_ZYNQ_FSBL_LATEST_VERSION
	default BR2_TARGET_ZYNQ_FSBL_CUSTOM_VERSION_VALUE \
		if BR2_TARGET_ZYNQ_FSBL_CUSTOM_VERSION
	default "custom" if BR2_TARGET_ZYNQ_FSBL_CUSTOM_TARBALL

config BR2_TARGET_ZYNQ_FSBL_BOARDNAME
	string "Zynq FSBL board name"
	default "zc702"
	help
	  One of U-Boot supported boards to be built,
	  availables: zc702, zc706, zed, zylaser.

config BR2_TARGET_ZYNQ_FSBL_DEBUG_INFO
	bool "Enable debugging output"
	help
	  Select this option if you need output debug messages.

config BR2_TARGET_ZYNQ_FSBL_MMC_SUPPORT
	bool "MMC Support"
	help
	  Select this option if you need from mmc/sd devices.

config BR2_TARGET_ZYNQ_FSBL_RSA_SUPPORT
	bool "RSA Support"
	help
	  Select this option if you need rsa authentication.

endif # BR2_TARGET_ZYNQ_FSBL
```

## configs/myimx6_defconfig
```kconfig
BR2_arm=y
BR2_cortex_a9=y
BR2_ARM_ENABLE_NEON=y
BR2_ARM_ENABLE_VFP=y
BR2_ARM_FPU_VFPV3=y
BR2_WGET="wget --passive-ftp -nd -t 3 --user=${WGET_USER} --password=${WGET_PASSWORD}"
BR2_GLOBAL_PATCH_DIR="board/myimx6/patches"
BR2_TOOLCHAIN_BUILDROOT_GLIBC=y
BR2_PACKAGE_HOST_LINUX_HEADERS_CUSTOM_3_0=y
BR2_BINUTILS_VERSION_2_27_X=y
BR2_GCC_VERSION_6_X=y
BR2_TOOLCHAIN_BUILDROOT_CXX=y
BR2_GCC_ENABLE_LTO=y
BR2_ROOTFS_DEVICE_CREATION_DYNAMIC_MDEV=y
BR2_TARGET_GENERIC_GETTY_PORT="ttymxc0"
BR2_ROOTFS_OVERLAY="board/myimx6/rootfs_overlay"
BR2_ROOTFS_POST_BUILD_SCRIPT="board/myimx6/pre-image.sh"
BR2_ROOTFS_POST_FAKEROOT_SCRIPT="board/myimx6/fakeroot.sh"
BR2_ROOTFS_POST_IMAGE_SCRIPT="board/myimx6/post-image.sh"
BR2_LINUX_KERNEL=y
BR2_LINUX_KERNEL_CUSTOM_TARBALL=y
BR2_LINUX_KERNEL_CUSTOM_TARBALL_LOCATION="http://10.0.2.2/cgit/rdst/linux-stable.git/snapshot/linux-stable-3.0.35-MY-IMX6-R4.tar.gz"
BR2_LINUX_KERNEL_USE_CUSTOM_CONFIG=y
BR2_LINUX_KERNEL_CUSTOM_CONFIG_FILE="board/myimx6/linux-3.0.35.config"
BR2_LINUX_KERNEL_UIMAGE=y
BR2_PACKAGE_QT5=y
BR2_PACKAGE_QT5_VERSION_5_6=y
BR2_PACKAGE_QT5BASE_LICENSE_APPROVED=y
BR2_PACKAGE_QT5BASE_OPENGL_LIB=y
BR2_PACKAGE_QT5BASE_LINUXFB=y
BR2_PACKAGE_QT5BASE_EGLFS=y
BR2_PACKAGE_QT5BASE_FONTCONFIG=y
BR2_PACKAGE_QT5BASE_GIF=y
BR2_PACKAGE_QT5BASE_JPEG=y
BR2_PACKAGE_QT5BASE_PNG=y
BR2_PACKAGE_QT5IMAGEFORMATS=y
BR2_PACKAGE_QT5XMLPATTERNS=y
BR2_PACKAGE_FREESCALE_IMX=y
BR2_PACKAGE_FREESCALE_IMX_PLATFORM_IMX6Q=y
BR2_PACKAGE_IMX_GPU_VIV_BIN_3_0_35_4_1_0=y
BR2_PACKAGE_UTIL_LINUX=y
BR2_PACKAGE_UTIL_LINUX_BINARIES=y
BR2_TARGET_ROOTFS_EXT2=y
BR2_TARGET_ROOTFS_EXT2_4=y
BR2_TARGET_UBOOT=y
BR2_TARGET_UBOOT_BOARDNAME="myimx6ek200_6q"
BR2_TARGET_UBOOT_CUSTOM_TARBALL=y
BR2_TARGET_UBOOT_CUSTOM_TARBALL_LOCATION="http://10.0.2.2/cgit/rdst/u-boot.git/snapshot/u-boot-2009.08-MY-IMX6-2.tar.xz"
BR2_TARGET_UBOOT_PATCH="myimx6ek200_6q"
BR2_PACKAGE_HOST_DOSFSTOOLS=y
BR2_PACKAGE_HOST_GENIMAGE=y
BR2_PACKAGE_HOST_MTOOLS=y
```

## configs/myzr_imx6qsabresd_defconfig
```kconfig
BR2_arm=y
BR2_cortex_a9=y
BR2_ARM_ENABLE_NEON=y
BR2_ARM_ENABLE_VFP=y
BR2_ARM_EABI=y
BR2_JLEVEL=4
BR2_CCACHE=y
BR2_GLOBAL_PATCH_DIR="board/myzr/imx6sabre/patches"
BR2_TOOLCHAIN_BUILDROOT_VENDOR="myimx6"
BR2_KERNEL_HEADERS_4_4=y
BR2_TOOLCHAIN_BUILDROOT_GLIBC=y
BR2_GLIBC_VERSION_2_24=y
BR2_BINUTILS_VERSION_2_27_X=y
BR2_GCC_VERSION_6_X=y
BR2_TOOLCHAIN_BUILDROOT_CXX=y
BR2_GCC_ENABLE_LTO=y
BR2_GCC_ENABLE_OPENMP=y
BR2_TOOLCHAIN_GLIBC_GCONV_LIBS_COPY=y
BR2_TARGET_GENERIC_HOSTNAME="myimx6"
BR2_TARGET_GENERIC_ISSUE="Welcome to MY-I.MX6Q"
BR2_TARGET_GENERIC_GETTY_PORT="ttymxc0"
BR2_ROOTFS_OVERLAY="board/myzr/imx6sabre/rootfs_overlay"
BR2_ROOTFS_POST_IMAGE_SCRIPT="board/myzr/imx6sabre/post-image.sh"
BR2_LINUX_KERNEL=y
BR2_LINUX_KERNEL_CUSTOM_VERSION=y
BR2_LINUX_KERNEL_CUSTOM_VERSION_VALUE="4.4.25"
BR2_LINUX_KERNEL_USE_CUSTOM_CONFIG=y
BR2_LINUX_KERNEL_CUSTOM_CONFIG_FILE="board/myzr/imx6sabre/linux-4.4.y.config"
BR2_LINUX_KERNEL_APPENDED_UIMAGE=y
BR2_LINUX_KERNEL_UIMAGE_LOADADDR="0x10008000"
BR2_LINUX_KERNEL_INTREE_DTS_NAME="imx6q-sabresd"
BR2_TARGET_ROOTFS_EXT2=y
BR2_TARGET_ROOTFS_EXT2_4=y
BR2_PACKAGE_HOST_DOSFSTOOLS=y
BR2_PACKAGE_HOST_GENIMAGE=y
BR2_PACKAGE_HOST_MTOOLS=y
```

## configs/myzr_myimx6ek200_6q_3.14.52_defconfig
```kconfig
BR2_arm=y
BR2_cortex_a9=y
BR2_ARM_ENABLE_NEON=y
BR2_ARM_ENABLE_VFP=y
BR2_ARM_FPU_NEON=y
BR2_KERNEL_MIRROR="https://www.kernel.org/pub"
BR2_GNU_MIRROR="http://ftp.gnu.org/pub/gnu"
BR2_JLEVEL=4
BR2_GLOBAL_PATCH_DIR="board/myzr/myimx6ek200-6q/patches"
# BR2_COMPILER_PARANOID_UNSAFE_PATH is not set
BR2_TOOLCHAIN_BUILDROOT_VENDOR="myimx6ek200"
BR2_TOOLCHAIN_BUILDROOT_GLIBC=y
BR2_PACKAGE_HOST_LINUX_HEADERS_CUSTOM_3_14=y
BR2_GLIBC_VERSION_2_24=y
BR2_BINUTILS_VERSION_2_27_X=y
BR2_GCC_VERSION_4_9_X=y
BR2_TOOLCHAIN_BUILDROOT_CXX=y
BR2_GCC_ENABLE_LTO=y
BR2_GCC_ENABLE_OPENMP=y
BR2_PACKAGE_HOST_GDB=y
BR2_GDB_VERSION_7_9=y
BR2_TOOLCHAIN_GLIBC_GCONV_LIBS_COPY=y
BR2_TARGET_GENERIC_HOSTNAME="rdst"
BR2_TARGET_GENERIC_ISSUE="Welcome to MY-IMX6EK200-6Q"
BR2_ROOTFS_DEVICE_CREATION_DYNAMIC_MDEV=y
BR2_TARGET_GENERIC_GETTY_PORT="ttymxc0"
# BR2_TARGET_GENERIC_REMOUNT_ROOTFS_RW is not set
BR2_ENABLE_LOCALE_WHITELIST="C en_US zh_CN zh_TW"
BR2_GENERATE_LOCALE="en_US zh_CN zh_TW"
BR2_TARGET_TZ_INFO=y
BR2_TARGET_LOCALTIME="Asia/Shanghai"
BR2_ROOTFS_OVERLAY="board/myzr/myimx6ek200-6q/rootfs_overlay"
BR2_ROOTFS_POST_BUILD_SCRIPT="board/myzr/myimx6ek200-6q/pre-image.sh"
BR2_ROOTFS_POST_FAKEROOT_SCRIPT="board/myzr/myimx6ek200-6q/fakeroot.sh"
BR2_ROOTFS_POST_IMAGE_SCRIPT="board/myzr/myimx6ek200-6q/post-image.sh"
BR2_LINUX_KERNEL=y
BR2_LINUX_KERNEL_CUSTOM_TARBALL=y
BR2_LINUX_KERNEL_CUSTOM_TARBALL_LOCATION="https://a000:a000,,100200@10.0.2.2/cgit/rdst/linux-stable.git/snapshot/linux-stable-3.14.52-myimx6-r88.tar.bz2"
BR2_LINUX_KERNEL_PATCH="board/myzr/myimx6ek200-6q/patches/linux/3.14.52"
BR2_LINUX_KERNEL_USE_CUSTOM_CONFIG=y
BR2_LINUX_KERNEL_CUSTOM_CONFIG_FILE="board/myzr/myimx6ek200-6q/linux-3.14.52-myimx6-r88.config"
BR2_LINUX_KERNEL_DTS_SUPPORT=y
BR2_LINUX_KERNEL_INTREE_DTS_NAME="myimx6ek200-6q"
BR2_LINUX_KERNEL_INSTALL_TARGET=y
BR2_PACKAGE_BUSYBOX_CONFIG="board/myzr/common/busybox.config"
BR2_PACKAGE_BUSYBOX_WATCHDOG=y
BR2_PACKAGE_GDB=y
BR2_PACKAGE_DEJAVU=y
BR2_PACKAGE_FBDUMP=y
BR2_PACKAGE_FBGRAB=y
BR2_PACKAGE_FB_TEST_APP=y
BR2_PACKAGE_FBV=y
BR2_PACKAGE_IMAGEMAGICK=y
BR2_PACKAGE_SDL2=y
BR2_PACKAGE_QT5=y
BR2_PACKAGE_QT5BASE_LICENSE_APPROVED=y
BR2_PACKAGE_QT5BASE_EXAMPLES=y
BR2_PACKAGE_QT5BASE_CONCURRENT=y
BR2_PACKAGE_QT5BASE_SQLITE_SYSTEM=y
BR2_PACKAGE_QT5BASE_LINUXFB=y
BR2_PACKAGE_QT5BASE_EGLFS=y
BR2_PACKAGE_QT5BASE_FONTCONFIG=y
BR2_PACKAGE_QT5BASE_GIF=y
BR2_PACKAGE_QT5BASE_JPEG=y
BR2_PACKAGE_QT5BASE_PNG=y
BR2_PACKAGE_QT5BASE_ICU=y
BR2_PACKAGE_QT5BASE_TSLIB=y
BR2_PACKAGE_QT5CANVAS3D=y
BR2_PACKAGE_QT5ENGINIO=y
BR2_PACKAGE_QT5GRAPHICALEFFECTS=y
BR2_PACKAGE_QT5IMAGEFORMATS=y
BR2_PACKAGE_QT5LOCATION=y
BR2_PACKAGE_QT5MULTIMEDIA=y
BR2_PACKAGE_QT5QUICKCONTROLS=y
BR2_PACKAGE_QT5SENSORS=y
BR2_PACKAGE_QT5SVG=y
BR2_PACKAGE_QT5WEBCHANNEL=y
BR2_PACKAGE_QT53D=y
BR2_PACKAGE_QT5QUICKCONTROLS2=y
BR2_PACKAGE_QT5SERIALBUS=y
BR2_PACKAGE_LINUX_FIRMWARE=y
BR2_PACKAGE_FREESCALE_IMX=y
BR2_PACKAGE_FREESCALE_IMX_PLATFORM_IMX6Q=y
BR2_PACKAGE_IMX_CODEC=y
BR2_PACKAGE_IMX_KOBS=y
BR2_PACKAGE_IMX_LIB=y
BR2_PACKAGE_IMX_PARSER=y
BR2_PACKAGE_IMX_VPUWRAP=y
BR2_PACKAGE_IMX_GPU_VIV=y
BR2_PACKAGE_KERNEL_MODULE_IMX_GPU_VIV=y
BR2_PACKAGE_SQLITE_STAT3=y
BR2_PACKAGE_SQLITE_ENABLE_FTS3=y
BR2_PACKAGE_SQLITE_ENABLE_UNLOCK_NOTIFY=y
BR2_PACKAGE_SQLITE_SECURE_DELETE=y
BR2_PACKAGE_LIBJPEG=y
BR2_PACKAGE_LIBQRENCODE=y
BR2_PACKAGE_LIBQRENCODE_TOOLS=y
BR2_PACKAGE_LIBSVG_CAIRO=y
BR2_PACKAGE_OPENCV=y
BR2_PACKAGE_OPENCV_LIB_GPU=y
BR2_PACKAGE_OPENCV_WITH_FFMPEG=y
BR2_PACKAGE_OPENCV_WITH_JASPER=y
BR2_PACKAGE_OPENCV_WITH_JPEG=y
BR2_PACKAGE_OPENCV_WITH_PNG=y
BR2_PACKAGE_OPENCV_WITH_TIFF=y
BR2_PACKAGE_OPENCV_WITH_V4L=y
BR2_PACKAGE_OPENCV_INSTALL_DATA=y
BR2_PACKAGE_PANGO=y
BR2_PACKAGE_LIBV4L=y
BR2_PACKAGE_LIBV4L_UTILS=y
BR2_PACKAGE_GLM=y
BR2_PACKAGE_PCRE_32=y
BR2_PACKAGE_READLINE=y
BR2_PACKAGE_OPENSSH=y
BR2_TARGET_ROOTFS_TAR_BZIP2=y
BR2_TARGET_UBOOT=y
BR2_TARGET_UBOOT_BOARDNAME="myimx6ek200-6q"
BR2_TARGET_UBOOT_CUSTOM_TARBALL=y
BR2_TARGET_UBOOT_CUSTOM_TARBALL_LOCATION="https://a000:a000,,100200@10.0.2.2/cgit/rdst/u-boot.git/snapshot/u-boot-2015.04-myimx6-r70-2.tar.bz2"
BR2_TARGET_UBOOT_FORMAT_IMX=y
BR2_PACKAGE_HOST_DOSFSTOOLS=y
BR2_PACKAGE_HOST_MKE2IMG=y
BR2_PACKAGE_HOST_UBOOT_TOOLS=y
```
