## configs/tdc_etlmd_v2_lp_defconfig
```kconfig
BR2_x86_64=y
BR2_x86_core2=y
BR2_WGET="wget --passive-ftp -nd -t 3 --user=${WGET_USER} --password=${WGET_PASSWORD}"
BR2_GLOBAL_PATCH_DIR="board/tdc/etlmd-v2/patches"
BR2_TOOLCHAIN_BUILDROOT_VENDOR="etlmdv2"
BR2_TOOLCHAIN_BUILDROOT_GLIBC=y
BR2_PACKAGE_HOST_LINUX_HEADERS_CUSTOM_4_4=y
BR2_GLIBC_VERSION_2_24=y
BR2_BINUTILS_VERSION_2_27_X=y
BR2_GCC_VERSION_6_X=y
BR2_TOOLCHAIN_BUILDROOT_CXX=y
BR2_GCC_ENABLE_LTO=y
BR2_GCC_ENABLE_OPENMP=y
BR2_TOOLCHAIN_GLIBC_GCONV_LIBS_COPY=y
BR2_TARGET_GENERIC_HOSTNAME="etlmdv2lp"
BR2_TARGET_GENERIC_ISSUE="Welcome to ETLMD v2 (LP)"
BR2_ROOTFS_DEVICE_TABLE="board/tdc/etlmd-v2-lp/device_table.txt"
BR2_TARGET_GENERIC_ROOT_PASSWD="iaos%55/20"
# BR2_TARGET_GENERIC_GETTY is not set
# BR2_TARGET_GENERIC_REMOUNT_ROOTFS_RW is not set
BR2_SYSTEM_DHCP="eth0"
BR2_ENABLE_LOCALE_WHITELIST="C en_US zh_CN zh_TW"
BR2_TARGET_TZ_INFO=y
BR2_TARGET_LOCALTIME="Asia/Shanghai"
BR2_ROOTFS_OVERLAY="board/tdc/etlmd-v2-lp/rootfs_overlay"
BR2_ROOTFS_POST_BUILD_SCRIPT="board/tdc/etlmd-v2-lp/pre-image.sh"
BR2_ROOTFS_POST_FAKEROOT_SCRIPT="board/tdc/etlmd-v2-lp/fakeroot.sh"
BR2_ROOTFS_POST_IMAGE_SCRIPT="board/tdc/etlmd-v2-lp/post-image.sh"
BR2_LINUX_KERNEL=y
BR2_LINUX_KERNEL_CUSTOM_TARBALL=y
BR2_LINUX_KERNEL_CUSTOM_TARBALL_LOCATION="https://10.0.2.2/cgit/rdst/linux-stable.git/snapshot/linux-stable-4.4.43.tar.bz2"
BR2_LINUX_KERNEL_USE_CUSTOM_CONFIG=y
BR2_LINUX_KERNEL_CUSTOM_CONFIG_FILE="board/tdc/etlmd-v2-lp/linux-4.4.y.config"
BR2_PACKAGE_BUSYBOX_CUSTOM_TARBALL=y
BR2_PACKAGE_BUSYBOX_CUSTOM_TARBALL_LOCATION="https://10.0.2.2/cgit/rdst/busybox.git/snapshot/busybox-1_26_4.tar.bz2"
BR2_PACKAGE_BUSYBOX_CUSTOM_TARBALL_STRIP_COMPONENTS=1
BR2_PACKAGE_BUSYBOX_CONFIG="board/tdc/common/busybox.config"
BR2_PACKAGE_BUSYBOX_WATCHDOG=y
BR2_PACKAGE_LIBAV=y
BR2_PACKAGE_LIBAV_GPL=y
BR2_PACKAGE_LIBAV_NONFREE=y
BR2_PACKAGE_LIBAV_AVPROBE=y
BR2_PACKAGE_LIBAV_AVRESAMPLE=y
BR2_PACKAGE_LIBAV_POSTPROC=y
BR2_PACKAGE_LIBAV_SWSCALE=y
BR2_PACKAGE_BZIP2=y
BR2_PACKAGE_JQ=y
BR2_PACKAGE_DOSFSTOOLS=y
BR2_PACKAGE_DOSFSTOOLS_FATLABEL=y
BR2_PACKAGE_DOSFSTOOLS_FSCK_FAT=y
BR2_PACKAGE_DOSFSTOOLS_MKFS_FAT=y
BR2_PACKAGE_E2FSPROGS=y
BR2_PACKAGE_E2FSPROGS_E4DEFRAG=y
BR2_PACKAGE_E2FSPROGS_FUSE2FS=y
BR2_PACKAGE_E2FSPROGS_RESIZE2FS=y
BR2_PACKAGE_FB_TEST_APP=y
BR2_PACKAGE_ACPID=y
BR2_PACKAGE_GPTFDISK=y
BR2_PACKAGE_GPTFDISK_GDISK=y
BR2_PACKAGE_GPTFDISK_SGDISK=y
BR2_PACKAGE_NODEJS=y
BR2_PACKAGE_NODEJS_NPM=y
BR2_PACKAGE_NODEJS_MODULES_ADDITIONAL="debug ejs forever fs-extra body-parser cookie-parser log4js multer multiparty node-ssdp serve-index serve-static tracer diskusage posix ftp express"
BR2_PACKAGE_PYTHON3=y
BR2_PACKAGE_PYTHON3_CODECSCJK=y
BR2_PACKAGE_PYTHON3_DECIMAL=y
BR2_PACKAGE_PYTHON3_READLINE=y
BR2_PACKAGE_PYTHON3_SSL=y
BR2_PACKAGE_PYTHON3_SQLITE=y
BR2_PACKAGE_PYTHON3_ZLIB=y
BR2_PACKAGE_ALSA_LIB=y
BR2_PACKAGE_OPENSSL_BIN=y
BR2_PACKAGE_FONTCONFIG=y
BR2_PACKAGE_LIBDRM_INTEL=y
BR2_PACKAGE_LIBDRM_RADEON=y
BR2_PACKAGE_LIBDRM_AMDGPU=y
BR2_PACKAGE_LIBDRM_NOUVEAU=y
BR2_PACKAGE_LIBDRM_VMWGFX=y
BR2_PACKAGE_LIBVA=y
BR2_PACKAGE_OPENCV=y
BR2_PACKAGE_OPENCV_LIB_GPU=y
BR2_PACKAGE_OPENCV_LIB_NONFREE=y
BR2_PACKAGE_OPENCV_WITH_JASPER=y
BR2_PACKAGE_OPENCV_WITH_JPEG=y
BR2_PACKAGE_OPENCV_WITH_PNG=y
BR2_PACKAGE_OPENCV_WITH_TIFF=y
BR2_PACKAGE_OPENCV_WITH_V4L=y
BR2_PACKAGE_OPENCV_INSTALL_DATA=y
BR2_PACKAGE_TSLIB=y
BR2_PACKAGE_LIBXML2=y
BR2_PACKAGE_X264=y
BR2_PACKAGE_X265=y
BR2_PACKAGE_LINUX_PAM=y
BR2_PACKAGE_ICU=y
BR2_PACKAGE_PCRE=y
BR2_PACKAGE_PCRE_16=y
BR2_PACKAGE_PCRE_32=y
BR2_PACKAGE_PCRE_UCP=y
BR2_PACKAGE_TDC=y
BR2_PACKAGE_ETLMD_IA=y
BR2_PACKAGE_ETLMD_IA_CUSTOM_VERSION=y
BR2_PACKAGE_ETLMD_IA_BGP=y
BR2_PACKAGE_ETLMD_IA_DATA=y
BR2_PACKAGE_ETLMD_IA_SCRIPTS=y
BR2_PACKAGE_ETLMD_IA_WS=y
BR2_PACKAGE_LIBPES_LEGACY=y
BR2_PACKAGE_LIBSBC=y
BR2_PACKAGE_LIBSTREAM_LEGACY=y
BR2_PACKAGE_XPR_LEGACY=y
BR2_PACKAGE_OPENSSH=y
BR2_PACKAGE_PROFTPD=y
BR2_PACKAGE_PROFTPD_MOD_REWRITE=y
BR2_PACKAGE_OPKG=y
BR2_PACKAGE_OPKG_GPG_SIGN=y
BR2_PACKAGE_DIALOG=y
BR2_PACKAGE_FILE=y
BR2_PACKAGE_GNUPG_AES=y
BR2_PACKAGE_GNUPG_RSA=y
BR2_PACKAGE_GNUPG_GPGV=y
BR2_PACKAGE_GNUPG_GPGSPLIT=y
BR2_PACKAGE_INCRON=y
BR2_PACKAGE_MONIT=y
BR2_PACKAGE_UTIL_LINUX_LIBMOUNT=y
BR2_PACKAGE_UTIL_LINUX_LSBLK=y
BR2_TARGET_ROOTFS_EXT2=y
BR2_TARGET_ROOTFS_SQUASHFS=y
# BR2_TARGET_ROOTFS_TAR is not set
```

## configs/tdc_hi3531_defconfig
```kconfig
BR2_arm=y
BR2_cortex_a9=y
BR2_ARM_ENABLE_VFP=y
BR2_ARM_EABI=y
BR2_WGET="wget --passive-ftp -nd -t 3 --no-check-certificate"
BR2_TOOLCHAIN_BUILDROOT_VENDOR="none"
BR2_PACKAGE_HOST_LINUX_HEADERS_CUSTOM_3_0=y
BR2_TOOLCHAIN_BUILDROOT_LOCALE=y
BR2_PTHREAD_DEBUG=y
BR2_TOOLCHAIN_BUILDROOT_USE_SSP=y
BR2_BINUTILS_VERSION_2_27_X=y
BR2_GCC_VERSION_4_9_X=y
BR2_TOOLCHAIN_BUILDROOT_CXX=y
BR2_GCC_ENABLE_LTO=y
BR2_GCC_ENABLE_OPENMP=y
BR2_GCC_ENABLE_GRAPHITE=y
BR2_TARGET_GENERIC_HOSTNAME="rdst"
BR2_TARGET_GENERIC_ISSUE="Welcome to Hi3531"
BR2_TARGET_GENERIC_GETTY_PORT="ttyAMA0"
BR2_SYSTEM_DHCP="eth0"
BR2_TARGET_TZ_INFO=y
BR2_TARGET_LOCALTIME="Asia/Shanghai"
BR2_ROOTFS_OVERLAY="board/tdc/hi3531/rootfs_overlay"
BR2_ROOTFS_POST_BUILD_SCRIPT="board/tdc/hi3531/pre-image.sh"
BR2_ROOTFS_POST_FAKEROOT_SCRIPT="board/tdc/hi3531/fakeroot.sh"
BR2_ROOTFS_POST_IMAGE_SCRIPT="board/tdc/hi3531/post-image.sh"
BR2_LINUX_KERNEL=y
BR2_LINUX_KERNEL_CUSTOM_TARBALL=y
BR2_LINUX_KERNEL_CUSTOM_TARBALL_LOCATION="https://a000:a000,,100200@10.0.2.2/cgit/rdst/linux-stable.git/snapshot/linux-stable-3.0.101-hi3531.tar.bz2"
BR2_LINUX_KERNEL_USE_CUSTOM_CONFIG=y
BR2_LINUX_KERNEL_CUSTOM_CONFIG_FILE="board/tdc/hi3531/linux-3.0.y-hi3531.config"
BR2_LINUX_KERNEL_UIMAGE=y
BR2_PACKAGE_HISILICON=y
BR2_PACKAGE_HI3531_MPP_DRV=y
BR2_TARGET_ROOTFS_EXT2=y
# BR2_TARGET_ROOTFS_TAR is not set
```

## configs/tdc_hinvr_hi3520d_defconfig
```kconfig
BR2_arm=y
BR2_cortex_a9=y
BR2_WGET="wget --passive-ftp -nd -t 3 --no-check-certificate --user=${WGET_USER} --password=${WGET_PASSWORD}"
BR2_PREFER_STATIC_LIB=y
BR2_GLOBAL_PATCH_DIR="board/tdc/hinvr-hi3520d/patches"
BR2_TOOLCHAIN_BUILDROOT_VENDOR="hinvr"
BR2_KERNEL_HEADERS_VERSION=y
BR2_DEFAULT_KERNEL_VERSION="3.0.8"
BR2_PACKAGE_HOST_LINUX_HEADERS_CUSTOM_3_0=y
BR2_UCLIBC_VERSION_0_9_32=y
BR2_UCLIBC_CONFIG="board/tdc/hinvr-hi3520d/uClibc-0.9.32.config"
BR2_TOOLCHAIN_BUILDROOT_LARGEFILE=y
BR2_TOOLCHAIN_BUILDROOT_INET_RPC=y
BR2_TOOLCHAIN_BUILDROOT_LOCALE=y
BR2_TOOLCHAIN_BUILDROOT_USE_SSP=y
# BR2_UCLIBC_INSTALL_UTILS is not set
BR2_GCC_VERSION_4_4_X=y
BR2_TOOLCHAIN_BUILDROOT_CXX=y
BR2_PACKAGE_HOST_GDB=y
BR2_TARGET_GENERIC_HOSTNAME="hinvr-hi3520d"
BR2_TARGET_GENERIC_ISSUE="Welcome to HiNVR (Hi3520D)"
BR2_ROOTFS_DEVICE_TABLE="board/tdc/hinvr-hi3520d/device_table.txt"
BR2_TARGET_GENERIC_GETTY_PORT="ttyAMA0"
BR2_TARGET_TZ_INFO=y
BR2_TARGET_LOCALTIME="Asia/Shanghai"
# BR2_TARGET_GENERIC_REMOUNT_ROOTFS_RW is not set
BR2_ROOTFS_OVERLAY="board/tdc/hinvr-hi3520d/rootfs_overlay"
BR2_ROOTFS_POST_BUILD_SCRIPT="board/tdc/hinvr-hi3520d/pre-image.sh"
BR2_ROOTFS_POST_IMAGE_SCRIPT="board/tdc/hinvr-hi3520d/post-image.sh"
BR2_LINUX_KERNEL=y
BR2_LINUX_KERNEL_CUSTOM_TARBALL=y
BR2_LINUX_KERNEL_CUSTOM_TARBALL_LOCATION="https://10.0.2.2/cgit/rdst/linux-stable.git/snapshot/linux-stable-3.0.8-Hi3520D-V1.0.5.0-R2.tar.gz"
BR2_LINUX_KERNEL_PATCH="board/tdc/hinvr-hi3520d/patches/linux/3.0.8"
BR2_LINUX_KERNEL_USE_CUSTOM_CONFIG=y
BR2_LINUX_KERNEL_CUSTOM_CONFIG_FILE="board/tdc/hinvr-hi3520d/linux-3.0.8-mini.config"
BR2_PACKAGE_BUSYBOX_WATCHDOG=y
BR2_PACKAGE_GSTREAMER1=y
# BR2_PACKAGE_GSTREAMER1_PARSE is not set
# BR2_PACKAGE_GSTREAMER1_PLUGIN_REGISTRY is not set
# BR2_PACKAGE_GSTREAMER1_INSTALL_TOOLS is not set
BR2_PACKAGE_GST1_PLUGINS_BASE_PLUGIN_APP=y
BR2_PACKAGE_GST1_PLUGINS_BASE_PLUGIN_AUDIORATE=y
BR2_PACKAGE_GST1_PLUGINS_BASE_PLUGIN_AUDIOTESTSRC=y
BR2_PACKAGE_GST1_PLUGINS_BASE_PLUGIN_ENCODING=y
BR2_PACKAGE_GST1_PLUGINS_BASE_PLUGIN_VIDEOCONVERT=y
BR2_PACKAGE_GST1_PLUGINS_BASE_PLUGIN_GIO=y
BR2_PACKAGE_GST1_PLUGINS_BASE_PLUGIN_SUBPARSE=y
BR2_PACKAGE_GST1_PLUGINS_BASE_PLUGIN_TCP=y
BR2_PACKAGE_GST1_PLUGINS_BASE_PLUGIN_VIDEOTESTSRC=y
BR2_PACKAGE_GST1_PLUGINS_BASE_PLUGIN_VIDEORATE=y
BR2_PACKAGE_GST1_PLUGINS_GOOD=y
# BR2_PACKAGE_GST1_PLUGINS_GOOD_PLUGIN_AVI is not set
BR2_PACKAGE_GST1_PLUGINS_GOOD_PLUGIN_MULTIFILE=y
BR2_PACKAGE_GST1_PLUGINS_GOOD_PLUGIN_MULTIPART=y
BR2_PACKAGE_GST1_PLUGINS_GOOD_PLUGIN_RTP=y
BR2_PACKAGE_GST1_PLUGINS_GOOD_PLUGIN_RTPMANAGER=y
BR2_PACKAGE_GST1_PLUGINS_GOOD_PLUGIN_RTSP=y
BR2_PACKAGE_GST1_PLUGINS_GOOD_PLUGIN_UDP=y
# BR2_PACKAGE_GST1_PLUGINS_GOOD_PLUGIN_WAVPARSE is not set
BR2_PACKAGE_GST1_PLUGINS_BAD=y
BR2_PACKAGE_GST1_PLUGINS_BAD_PLUGIN_VIDEOPARSERS=y
BR2_PACKAGE_MTD=y
# BR2_PACKAGE_MTD_FLASHCP is not set
# BR2_PACKAGE_MTD_FLASH_ERASE is not set
# BR2_PACKAGE_MTD_FLASH_LOCK is not set
# BR2_PACKAGE_MTD_FLASH_UNLOCK is not set
BR2_PACKAGE_MTD_MKFSJFFS2=y
# BR2_PACKAGE_MTD_MTD_DEBUG is not set
# BR2_PACKAGE_MTD_NANDDUMP is not set
# BR2_PACKAGE_MTD_NANDTEST is not set
# BR2_PACKAGE_MTD_NANDWRITE is not set
# BR2_PACKAGE_MTD_MTDINFO is not set
# BR2_PACKAGE_MTD_UBIATTACH is not set
# BR2_PACKAGE_MTD_UBICRC32 is not set
# BR2_PACKAGE_MTD_UBIDETACH is not set
# BR2_PACKAGE_MTD_UBIFORMAT is not set
# BR2_PACKAGE_MTD_UBIMKVOL is not set
# BR2_PACKAGE_MTD_UBINFO is not set
# BR2_PACKAGE_MTD_UBINIZE is not set
# BR2_PACKAGE_MTD_UBIRENAME is not set
# BR2_PACKAGE_MTD_UBIRMVOL is not set
# BR2_PACKAGE_MTD_UBIRSVOL is not set
# BR2_PACKAGE_MTD_UBIUPDATEVOL is not set
# BR2_PACKAGE_MTD_UBIBLOCK is not set
BR2_PACKAGE_QT=y
BR2_PACKAGE_QT_LICENSE_APPROVED=y
BR2_PACKAGE_QT_CONFIG_FILE="board/tdc/hinvr-hi3520d/qt-4.8-qconfig-lite.h"
BR2_PACKAGE_QT_PIXEL_DEPTH_15=y
BR2_PACKAGE_QT_PIXEL_DEPTH_24=y
# BR2_PACKAGE_QT_FONT_MICRO is not set
# BR2_PACKAGE_QT_FONT_FIXED is not set
# BR2_PACKAGE_QT_FONT_HELVETICA is not set
BR2_PACKAGE_QT_SYSTEMFREETYPE=y
BR2_PACKAGE_QT_QTJPEG=y
BR2_PACKAGE_QT_SYSTEMPNG=y
BR2_PACKAGE_QT_SYSTEMZLIB=y
BR2_PACKAGE_QT_MOUSE_PC=y
BR2_PACKAGE_QT_MOUSE_LINUXTP=y
BR2_PACKAGE_QT_MOUSE_LINUXINPUT=y
BR2_PACKAGE_QT_KEYBOARD_LINUXINPUT=y
# BR2_PACKAGE_QT_XML is not set
# BR2_PACKAGE_QT_SCRIPT is not set
BR2_PACKAGE_HISILICON=y
BR2_PACKAGE_HISILICON_PLATFORM_HI3520D=y
BR2_PACKAGE_HISILICON_SDK_VERSION_V1_0_5_0=y
BR2_PACKAGE_MPP_KO=y
BR2_PACKAGE_MPP_LIB=y
BR2_PACKAGE_REG_TOOLS=y
BR2_PACKAGE_REG_TOOLS_GPIO_I2C=y
BR2_PACKAGE_FONTCONFIG=y
BR2_PACKAGE_LIVE555=y
BR2_PACKAGE_LIVE555_CUSTOM_TARBALL=y
BR2_PACKAGE_LIVE555_CUSTOM_TARBALL_LOCATION="https://10.0.2.2/cgit/rdst/live.git/snapshot/live-2018.09.10.tar.gz"
BR2_PACKAGE_LIVE555_CUSTOM_TARBALL_STRIP_COMPONENTS=1
BR2_PACKAGE_LIVE555_FORCE_STATIC_LIBS=y
BR2_PACKAGE_TDC=y
BR2_PACKAGE_HINVR_QT=y
BR2_PACKAGE_HINVR_QT_CUSTOM_VERSION=y
BR2_TARGET_ROOTFS_SQUASHFS=y
BR2_TARGET_ROOTFS_SQUASHFS4_XZ=y
BR2_TARGET_ROOTFS_TAR_XZ=y
BR2_TARGET_UBOOT=y
BR2_TARGET_UBOOT_BOARDNAME="hi3520d"
BR2_TARGET_UBOOT_CUSTOM_TARBALL=y
BR2_TARGET_UBOOT_CUSTOM_TARBALL_LOCATION="https://10.0.2.2/cgit/rdst/u-boot.git/snapshot/u-boot-2010.06-Hi3520D-V1.0.5.0-R1.tar.gz"
BR2_PACKAGE_HOST_DOSFSTOOLS=y
BR2_PACKAGE_HOST_E2FSPROGS=y
BR2_PACKAGE_HOST_GENEXT2FS=y
BR2_PACKAGE_HOST_GENIMAGE=y
BR2_PACKAGE_HOST_MTD=y
BR2_PACKAGE_HOST_MTOOLS=y
BR2_PACKAGE_HOST_SQUASHFS=y
```
