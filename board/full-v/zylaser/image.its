## configs/tdc_cvr_mil_v3_4.1.15_defconfig
```kconfig
BR2_arm=y
BR2_cortex_a9=y
BR2_ARM_ENABLE_NEON=y
BR2_ARM_ENABLE_VFP=y
BR2_ARM_FPU_NEON=y
BR2_WGET="wget --passive-ftp -nd -t 3 --no-check-certificate --user=${WGET_USER} --password=${WGET_PASSWORD}"
BR2_KERNEL_MIRROR="https://www.kernel.org/pub"
BR2_GNU_MIRROR="http://ftp.gnu.org/pub/gnu"
BR2_GLOBAL_PATCH_DIR="board/tdc/cvr-mil-v3/patches"
# BR2_COMPILER_PARANOID_UNSAFE_PATH is not set
BR2_TOOLCHAIN_BUILDROOT_VENDOR="cvrmilv3"
BR2_TOOLCHAIN_BUILDROOT_GLIBC=y
BR2_PACKAGE_HOST_LINUX_HEADERS_CUSTOM_4_1=y
BR2_GLIBC_VERSION_2_24=y
BR2_BINUTILS_VERSION_2_27_X=y
BR2_TOOLCHAIN_BUILDROOT_CXX=y
BR2_GCC_ENABLE_LTO=y
BR2_GCC_ENABLE_OPENMP=y
BR2_PACKAGE_HOST_GDB=y
BR2_TOOLCHAIN_GLIBC_GCONV_LIBS_COPY=y
BR2_TARGET_GENERIC_HOSTNAME="cvr-mil-v3"
BR2_TARGET_GENERIC_ISSUE="Welcome to CVR-MIL-V3"
BR2_ROOTFS_DEVICE_CREATION_DYNAMIC_MDEV=y
BR2_ROOTFS_DEVICE_TABLE="board/tdc/cvr-mil-v3/device_table.txt"
BR2_TARGET_GENERIC_GETTY_PORT="ttymxc0"
# BR2_TARGET_GENERIC_REMOUNT_ROOTFS_RW is not set
BR2_ENABLE_LOCALE_WHITELIST="C en_US zh_CN zh_TW"
BR2_GENERATE_LOCALE="en_US zh_CN zh_TW"
BR2_TARGET_TZ_INFO=y
BR2_TARGET_LOCALTIME="Asia/Shanghai"
BR2_ROOTFS_OVERLAY="board/tdc/cvr-mil-v3/rootfs_overlay"
BR2_ROOTFS_POST_BUILD_SCRIPT="board/tdc/cvr-mil-v3/pre-image.sh"
BR2_ROOTFS_POST_FAKEROOT_SCRIPT="board/tdc/cvr-mil-v3/fakeroot.sh"
BR2_ROOTFS_POST_IMAGE_SCRIPT="board/tdc/cvr-mil-v3/post-image.sh"
BR2_LINUX_KERNEL=y
BR2_LINUX_KERNEL_CUSTOM_TARBALL=y
BR2_LINUX_KERNEL_CUSTOM_TARBALL_LOCATION="https://10.0.2.2/cgit/rdst/linux-stable.git/snapshot/linux-stable-4.1.15-imx_2.1.0_ga_2.tar.gz"
BR2_LINUX_KERNEL_PATCH="board/tdc/cvr-mil-v3/patches/linux/4.1.15"
BR2_LINUX_KERNEL_DEFCONFIG="myimx6"
BR2_LINUX_KERNEL_DTS_SUPPORT=y
BR2_LINUX_KERNEL_INTREE_DTS_NAME="myimx6ek200-6q myimx6ek200-6q-cm1.dtb myimx6ek200-6q-cm2 myimx6ek200-6q-cm3 myimx6ek200-6s myimx6ek200-6s-cm1.dtb myimx6ek200-6s-cm2 myimx6ek200-6s-cm3"
BR2_LINUX_KERNEL_INSTALL_TARGET=y
BR2_PACKAGE_BUSYBOX_CUSTOM_TARBALL=y
BR2_PACKAGE_BUSYBOX_CUSTOM_TARBALL_LOCATION="https://10.0.2.2/cgit/rdst/busybox.git/snapshot/busybox-1_26_6.tar.gz"
BR2_PACKAGE_BUSYBOX_CUSTOM_TARBALL_STRIP_COMPONENTS=1
BR2_PACKAGE_BUSYBOX_CONFIG="board/tdc/common/busybox.config"
BR2_PACKAGE_BUSYBOX_WATCHDOG=y
BR2_PACKAGE_FFMPEG_GPL=y
BR2_PACKAGE_FFMPEG_NONFREE=y
BR2_PACKAGE_FFMPEG_FFPLAY=y
BR2_PACKAGE_FFMPEG_EXTRACONF="--disable-debug --enable-small"
BR2_PACKAGE_GSTREAMER1=y
BR2_PACKAGE_GST1_PLUGINS_BASE_PLUGIN_AUDIOTESTSRC=y
BR2_PACKAGE_GST1_PLUGINS_BASE_PLUGIN_ENCODING=y
BR2_PACKAGE_GST1_PLUGINS_BASE_PLUGIN_VIDEOCONVERT=y
BR2_PACKAGE_GST1_PLUGINS_BASE_PLUGIN_VIDEOTESTSRC=y
BR2_PACKAGE_GST1_PLUGINS_BASE_PLUGIN_VIDEORATE=y
BR2_PACKAGE_GST1_PLUGINS_BASE_PLUGIN_ALSA=y
BR2_PACKAGE_GST1_PLUGINS_BASE_PLUGIN_OPUS=y
BR2_PACKAGE_GST1_PLUGINS_BASE_PLUGIN_PANGO=y
BR2_PACKAGE_GST1_PLUGINS_GOOD_PLUGIN_ALPHA=y
BR2_PACKAGE_GST1_PLUGINS_GOOD_PLUGIN_MATROSKA=y
BR2_PACKAGE_GST1_PLUGINS_GOOD_PLUGIN_MULTIFILE=y
BR2_PACKAGE_GST1_PLUGINS_GOOD_PLUGIN_MULTIPART=y
BR2_PACKAGE_GST1_PLUGINS_GOOD_PLUGIN_V4L2=y
BR2_PACKAGE_GST1_PLUGINS_BAD_PLUGIN_MPEGTSDEMUX=y
BR2_PACKAGE_GST1_PLUGINS_BAD_PLUGIN_MPEGTSMUX=y
BR2_PACKAGE_GST1_PLUGINS_BAD_PLUGIN_MPEGPSMUX=y
BR2_PACKAGE_GST1_PLUGINS_BAD_PLUGIN_VIDEOFILTERS=y
BR2_PACKAGE_GST1_PLUGINS_BAD_PLUGIN_VIDEOMEASURE=y
BR2_PACKAGE_GST1_PLUGINS_BAD_PLUGIN_VIDEOPARSERS=y
BR2_PACKAGE_GST1_PLUGINS_BAD_PLUGIN_VIDEOSIGNAL=y
BR2_PACKAGE_GST1_IMX=y
BR2_PACKAGE_GST1_IMX_EGLVISINK=y
BR2_PACKAGE_GST1_IMX_G2D=y
BR2_PACKAGE_GST1_IMX_IPU=y
BR2_PACKAGE_GST1_IMX_MP3ENCODER=y
BR2_PACKAGE_GST1_IMX_PXP=y
BR2_PACKAGE_GST1_IMX_UNIAUDIODEC=y
BR2_PACKAGE_GST1_IMX_VPU=y
BR2_PACKAGE_GST1_IMX_V4L2VIDEOSRC=y
BR2_PACKAGE_GST1_LIBAV=y
BR2_PACKAGE_GST1_RTSP_SERVER=y
BR2_PACKAGE_BZIP2=y
BR2_PACKAGE_GDB=y
BR2_PACKAGE_DOSFSTOOLS=y
BR2_PACKAGE_DOSFSTOOLS_FATLABEL=y
BR2_PACKAGE_DOSFSTOOLS_FSCK_FAT=y
BR2_PACKAGE_DOSFSTOOLS_MKFS_FAT=y
BR2_PACKAGE_E2FSPROGS=y
BR2_PACKAGE_F2FS_TOOLS=y
BR2_PACKAGE_DEJAVU=y
BR2_PACKAGE_FBDUMP=y
BR2_PACKAGE_FBGRAB=y
BR2_PACKAGE_FB_TEST_APP=y
BR2_PACKAGE_FBV=y
BR2_PACKAGE_QT5=y
BR2_PACKAGE_QT5_VERSION_5_6=y
BR2_PACKAGE_QT53D=y
BR2_PACKAGE_QT5BASE_LICENSE_APPROVED=y
BR2_PACKAGE_QT5BASE_EXAMPLES=y
BR2_PACKAGE_QT5BASE_SQLITE_SYSTEM=y
BR2_PACKAGE_QT5BASE_OPENGL_LIB=y
BR2_PACKAGE_QT5BASE_LINUXFB=y
BR2_PACKAGE_QT5BASE_EGLFS=y
BR2_PACKAGE_QT5BASE_FONTCONFIG=y
BR2_PACKAGE_QT5BASE_GIF=y
BR2_PACKAGE_QT5BASE_JPEG=y
BR2_PACKAGE_QT5BASE_PNG=y
BR2_PACKAGE_QT5BASE_ICU=y
BR2_PACKAGE_QT5BASE_TSLIB=y
BR2_PACKAGE_QT5GRAPHICALEFFECTS=y
BR2_PACKAGE_QT5IMAGEFORMATS=y
BR2_PACKAGE_LINUX_FIRMWARE=y
BR2_PACKAGE_FREESCALE_IMX=y
BR2_PACKAGE_FREESCALE_IMX_PLATFORM_IMX6Q=y
BR2_PACKAGE_IMX_CODEC=y
BR2_PACKAGE_IMX_KOBS=y
BR2_PACKAGE_IMX_LIB=y
BR2_PACKAGE_IMX_PARSER=y
BR2_PACKAGE_IMX_VPUWRAP=y
BR2_PACKAGE_IMX_GPU_VIV=y
BR2_PACKAGE_IMX_GPU_VIV_EXAMPLES=y
BR2_PACKAGE_IMX_GPU_VIV_G2D=y
BR2_PACKAGE_KERNEL_MODULE_IMX_GPU_VIV=y
BR2_PACKAGE_SQLITE_STAT3=y
BR2_PACKAGE_SQLITE_ENABLE_FTS3=y
BR2_PACKAGE_SQLITE_ENABLE_UNLOCK_NOTIFY=y
BR2_PACKAGE_SQLITE_SECURE_DELETE=y
BR2_PACKAGE_LIBJPEG=y
BR2_PACKAGE_LIBQRENCODE=y
BR2_PACKAGE_LIBQRENCODE_TOOLS=y
BR2_PACKAGE_TIFF=y
BR2_PACKAGE_LIBV4L=y
BR2_PACKAGE_LIBV4L_UTILS=y
BR2_PACKAGE_LIBIMXVPUAPI=y
BR2_PACKAGE_GLM=y
BR2_PACKAGE_PCRE_32=y
BR2_PACKAGE_READLINE=y
BR2_PACKAGE_OPENSSH=y
BR2_PACKAGE_UTIL_LINUX_BINARIES=y
BR2_TARGET_ROOTFS_SQUASHFS=y
BR2_TARGET_ROOTFS_TAR_GZIP=y
BR2_TARGET_UBOOT=y
BR2_TARGET_UBOOT_BOARDNAME="myimx6ek200-6q"
BR2_TARGET_UBOOT_CUSTOM_TARBALL=y
BR2_TARGET_UBOOT_CUSTOM_TARBALL_LOCATION="https://10.0.2.2/cgit/rdst/u-boot.git/snapshot/u-boot-2015.04-myimx6-r70-3.tar.bz2"
BR2_TARGET_UBOOT_FORMAT_IMX=y
BR2_PACKAGE_HOST_DOSFSTOOLS=y
BR2_PACKAGE_HOST_GENIMAGE=y
BR2_PACKAGE_HOST_MKE2IMG=y
BR2_PACKAGE_HOST_UBOOT_TOOLS=y
```

## configs/tdc_cvr_v1_defconfig
```kconfig
BR2_arm=y
BR2_cortex_a9=y
BR2_ARM_ENABLE_VFP=y
BR2_ARM_EABI=y
BR2_WGET="wget --passive-ftp -nd -t 3 --no-check-certificate --user=${WGET_USER} --password=${WGET_PASSWORD}"
BR2_GLOBAL_PATCH_DIR="board/tdc/cvr-v1/patches"
BR2_TOOLCHAIN_BUILDROOT_VENDOR="cvrv1"
BR2_PACKAGE_HOST_LINUX_HEADERS_CUSTOM_3_0=y
BR2_UCLIBC_VERSION_0_9_33=y
BR2_TOOLCHAIN_BUILDROOT_INET_RPC=y
BR2_TOOLCHAIN_BUILDROOT_WCHAR=y
BR2_PTHREAD_DEBUG=y
BR2_TOOLCHAIN_BUILDROOT_USE_SSP=y
BR2_BINUTILS_VERSION_2_27_X=y
BR2_GCC_VERSION_4_9_X=y
BR2_TOOLCHAIN_BUILDROOT_CXX=y
BR2_GCC_ENABLE_LTO=y
BR2_GCC_ENABLE_OPENMP=y
BR2_GCC_ENABLE_GRAPHITE=y
BR2_TARGET_GENERIC_HOSTNAME="cvr-v1"
BR2_TARGET_GENERIC_ISSUE="Welcome to CVR-V1"
BR2_ROOTFS_DEVICE_TABLE="board/tdc/cvr-v1/device_table.txt"
BR2_TARGET_GENERIC_GETTY_PORT="ttyAMA0"
# BR2_TARGET_GENERIC_REMOUNT_ROOTFS_RW is not set
BR2_SYSTEM_DHCP="eth0"
# BR2_ENABLE_LOCALE_PURGE is not set
BR2_TARGET_TZ_INFO=y
BR2_TARGET_LOCALTIME="Asia/Shanghai"
BR2_ROOTFS_OVERLAY="board/tdc/cvr-v1/rootfs_overlay"
BR2_ROOTFS_POST_BUILD_SCRIPT="board/tdc/cvr-v1/pre-image.sh"
BR2_ROOTFS_POST_FAKEROOT_SCRIPT="board/tdc/cvr-v1/fakeroot.sh"
BR2_ROOTFS_POST_IMAGE_SCRIPT="board/tdc/cvr-v1/post-image.sh"
BR2_LINUX_KERNEL=y
BR2_LINUX_KERNEL_CUSTOM_TARBALL=y
BR2_LINUX_KERNEL_CUSTOM_TARBALL_LOCATION="https://10.0.2.2/cgit/rdst/linux-stable.git/snapshot/linux-stable-3.0.8-Hi3531-V1.0.D.0-13.tar.bz2"
BR2_LINUX_KERNEL_PATCH="board/tdc/cvr-v1/patches/linux/3.0.8"
BR2_LINUX_KERNEL_USE_CUSTOM_CONFIG=y
BR2_LINUX_KERNEL_CUSTOM_CONFIG_FILE="board/tdc/cvr-v1/linux-3.0.8.config"
BR2_LINUX_KERNEL_UIMAGE=y
BR2_LINUX_KERNEL_XZ=y
BR2_PACKAGE_BUSYBOX_CUSTOM_TARBALL=y
BR2_PACKAGE_BUSYBOX_CUSTOM_TARBALL_LOCATION="https://10.0.2.2/cgit/rdst/busybox.git/snapshot/busybox-1_26_5.tar.bz2"
BR2_PACKAGE_BUSYBOX_CUSTOM_TARBALL_STRIP_COMPONENTS=1
BR2_PACKAGE_BUSYBOX_CONFIG="board/tdc/common/busybox.config"
BR2_PACKAGE_BUSYBOX_WATCHDOG=y
BR2_PACKAGE_ALSA_UTILS=y
BR2_PACKAGE_ALSA_UTILS_AMIXER=y
BR2_PACKAGE_ALSA_UTILS_APLAY=y
BR2_PACKAGE_FFMPEG=y
BR2_PACKAGE_FFMPEG_GPL=y
BR2_PACKAGE_FFMPEG_NONFREE=y
BR2_PACKAGE_FFMPEG_AVRESAMPLE=y
BR2_PACKAGE_FFMPEG_POSTPROC=y
BR2_PACKAGE_FFMPEG_SWSCALE=y
BR2_PACKAGE_GETTEXT=y
BR2_PACKAGE_JQ=y
BR2_PACKAGE_DOSFSTOOLS=y
BR2_PACKAGE_DOSFSTOOLS_FATLABEL=y
BR2_PACKAGE_DOSFSTOOLS_FSCK_FAT=y
BR2_PACKAGE_DOSFSTOOLS_MKFS_FAT=y
BR2_PACKAGE_F2FS_TOOLS=y
BR2_PACKAGE_MTD=y
BR2_PACKAGE_FB_TEST_APP=y
BR2_PACKAGE_QT=y
BR2_PACKAGE_QT_LICENSE_APPROVED=y
BR2_PACKAGE_QT_PIXEL_DEPTH_15=y
BR2_PACKAGE_QT_PIXEL_DEPTH_24=y
BR2_PACKAGE_QT_FONT_UNIFONT=y
BR2_PACKAGE_QT_SYSTEMFREETYPE=y
BR2_PACKAGE_QT_GIF=y
BR2_PACKAGE_QT_LIBMNG=y
BR2_PACKAGE_QT_SYSTEMJPEG=y
BR2_PACKAGE_QT_SYSTEMPNG=y
BR2_PACKAGE_QT_SYSTEMTIFF=y
BR2_PACKAGE_QT_ACCESSIBILITY=y
BR2_PACKAGE_QT_SYSTEMZLIB=y
BR2_PACKAGE_QT_SQL_MODULE=y
BR2_PACKAGE_QT_SQLITE_SYSTEM=y
BR2_PACKAGE_QT_MOUSE_PC=y
BR2_PACKAGE_QT_MOUSE_TSLIB=y
BR2_PACKAGE_QT_KEYBOARD_TTY=y
BR2_PACKAGE_QT_KEYBOARD_LINUXINPUT=y
BR2_PACKAGE_QT_XMLPATTERNS=y
BR2_PACKAGE_QT_MULTIMEDIA=y
BR2_PACKAGE_QT_AUDIO_BACKEND=y
BR2_PACKAGE_QT_SVG=y
BR2_PACKAGE_QT_STL=y
BR2_PACKAGE_QT_OPENSSL=y
# BR2_PACKAGE_QT_SCRIPT is not set
BR2_PACKAGE_QT_TEST=y
BR2_PACKAGE_HISILICON=y
BR2_PACKAGE_HISILICON_PLATFORM_HI3531=y
BR2_PACKAGE_MPP_KO=y
BR2_PACKAGE_MPP_LIB=y
BR2_PACKAGE_REG_TOOLS=y
BR2_PACKAGE_REG_TOOLS_GPIO_I2C=y
BR2_PACKAGE_LSSCSI=y
BR2_PACKAGE_LSHW=y
BR2_PACKAGE_JPEG_MPP_LIB=y
BR2_PACKAGE_EXPAT=y
BR2_PACKAGE_ZLOG=y
BR2_PACKAGE_LIVE555_CUSTOM_TARBALL=y
BR2_PACKAGE_LIVE555_CUSTOM_TARBALL_LOCATION="https://10.0.2.2/cgit/rdst/live.git/snapshot/live-2016.11.17-2.tar.bz2"
BR2_PACKAGE_LIVE555_CUSTOM_TARBALL_STRIP_COMPONENTS=1
BR2_PACKAGE_LIVE555_FORCE_STATIC_LIBS=y
BR2_PACKAGE_LIBMODBUS=y
BR2_PACKAGE_LIBINI=y
BR2_PACKAGE_TDC=y
BR2_PACKAGE_AAC_AUDIO_LIB=y
BR2_PACKAGE_LIBMAL=y
BR2_PACKAGE_LIBMAL_CUSTOM_VERSION=y
BR2_PACKAGE_LIBMAL_CUSTOM_VERSION_VALUE="1.0.2-CVR-V1"
BR2_PACKAGE_LIBPES_LEGACY=y
BR2_PACKAGE_LIBXD_MUXER=y
BR2_PACKAGE_LIBXD_PLAYER=y
BR2_PACKAGE_LIBXD_PLAYER_CUSTOM_VERSION=y
BR2_PACKAGE_LIBXD_PLAYER_CUSTOM_VERSION_VALUE="1.0.0-CVR-V1"
BR2_PACKAGE_LIBXD_STREAM=y
BR2_PACKAGE_LIBXD_STREAM_CUSTOM_VERSION=y
BR2_PACKAGE_LIBXD_STREAM_CUSTOM_VERSION_VALUE="4.2.1"
BR2_PACKAGE_VRS_PLUGINS=y
BR2_PACKAGE_VRS_PLUGINS_CUSTOM_VERSION=y
BR2_PACKAGE_VRS_QT=y
BR2_PACKAGE_VRS_QT_CUSTOM_VERSION=y
BR2_PACKAGE_VRS_QT_CUSTOM_VERSION_VALUE="1.0.3"
BR2_PACKAGE_XPR_CUSTOM_VERSION=y
BR2_PACKAGE_XPR_CUSTOM_VERSION_VALUE="2.0.1-CVR-V1"
BR2_PACKAGE_OPENSSH=y
BR2_PACKAGE_OPKG=y
BR2_PACKAGE_OPKG_GPG_SIGN=y
BR2_PACKAGE_GNUPG_AES=y
BR2_PACKAGE_GNUPG_RSA=y
BR2_PACKAGE_GNUPG_GPGV=y
BR2_PACKAGE_GNUPG_GPGSPLIT=y
BR2_PACKAGE_MONIT=y
BR2_PACKAGE_UTIL_LINUX_BINARIES=y
BR2_TARGET_ROOTFS_CRAMFS=y
BR2_TARGET_ROOTFS_SQUASHFS=y
BR2_TARGET_ROOTFS_SQUASHFS4_XZ=y
# BR2_TARGET_ROOTFS_TAR is not set
BR2_TARGET_UBOOT=y
BR2_TARGET_UBOOT_BOARDNAME="godnet"
BR2_TARGET_UBOOT_CUSTOM_TARBALL=y
BR2_TARGET_UBOOT_CUSTOM_TARBALL_LOCATION="https://10.0.2.2/cgit/rdst/u-boot.git/snapshot/u-boot-2010.06-Hi3531-V1.0.D.0-3.tar.bz2"
BR2_PACKAGE_HOST_GENIMAGE=y
BR2_PACKAGE_HOST_MKE2IMG=y
BR2_PACKAGE_HOST_MTOOLS=y
```

## configs/tdc_etlmd_v2_defconfig
```kconfig
BR2_x86_64=y
BR2_x86_core2=y
BR2_CCACHE=y
BR2_GLOBAL_PATCH_DIR="board/tdc/etlmd-v2/patches"
BR2_TOOLCHAIN_BUILDROOT_VENDOR="etlmdv2"
BR2_PACKAGE_HOST_LINUX_HEADERS_CUSTOM_4_4=y
BR2_TOOLCHAIN_BUILDROOT_GLIBC=y
BR2_GLIBC_VERSION_2_24=y
BR2_BINUTILS_VERSION_2_27_X=y
BR2_GCC_VERSION_6_X=y
BR2_TOOLCHAIN_BUILDROOT_CXX=y
BR2_GCC_ENABLE_LTO=y
BR2_GCC_ENABLE_OPENMP=y
BR2_TOOLCHAIN_GLIBC_GCONV_LIBS_COPY=y
BR2_TARGET_GENERIC_HOSTNAME="etlmdv2"
BR2_TARGET_GENERIC_ISSUE="Welcome to ETLMD v2"
BR2_ROOTFS_DEVICE_TABLE="board/tdc/etlmd-v2/device_table.txt"
# BR2_TARGET_GENERIC_GETTY is not set
# BR2_TARGET_GENERIC_REMOUNT_ROOTFS_RW is not set
BR2_SYSTEM_DHCP="eth0"
BR2_TARGET_TZ_INFO=y
BR2_TARGET_LOCALTIME="Asia/Shanghai"
BR2_ROOTFS_OVERLAY="board/tdc/etlmd-v2/rootfs_overlay"
BR2_ROOTFS_POST_BUILD_SCRIPT="board/tdc/etlmd-v2/pre-image.sh"
BR2_ROOTFS_POST_FAKEROOT_SCRIPT="board/tdc/etlmd-v2/post-fakeroot.sh"
BR2_ROOTFS_POST_IMAGE_SCRIPT="board/tdc/etlmd-v2/post-image.sh"
BR2_LINUX_KERNEL=y
BR2_LINUX_KERNEL_CUSTOM_VERSION=y
BR2_LINUX_KERNEL_CUSTOM_VERSION_VALUE="4.4.25"
BR2_LINUX_KERNEL_USE_CUSTOM_CONFIG=y
BR2_LINUX_KERNEL_CUSTOM_CONFIG_FILE="board/tdc/etlmd-v2/linux-4.4.y.config"
BR2_PACKAGE_BUSYBOX_CONFIG="board/tdc/common/busybox.config"
BR2_PACKAGE_BUSYBOX_WATCHDOG=y
BR2_PACKAGE_JQ=y
BR2_PACKAGE_DOSFSTOOLS=y
BR2_PACKAGE_DOSFSTOOLS_FATLABEL=y
BR2_PACKAGE_DOSFSTOOLS_FSCK_FAT=y
BR2_PACKAGE_DOSFSTOOLS_MKFS_FAT=y
BR2_PACKAGE_E2FSPROGS=y
BR2_PACKAGE_E2FSPROGS_E4DEFRAG=y
BR2_PACKAGE_E2FSPROGS_FUSE2FS=y
BR2_PACKAGE_E2FSPROGS_RESIZE2FS=y
BR2_PACKAGE_FB_TEST_APP=y
BR2_PACKAGE_MESA3D=y
BR2_PACKAGE_MESA3D_GALLIUM_DRIVER_NOUVEAU=y
BR2_PACKAGE_MESA3D_GALLIUM_DRIVER_R600=y
BR2_PACKAGE_MESA3D_GALLIUM_DRIVER_SVGA=y
BR2_PACKAGE_MESA3D_GALLIUM_DRIVER_SWRAST=y
BR2_PACKAGE_MESA3D_GALLIUM_DRIVER_VIRGL=y
BR2_PACKAGE_MESA3D_DRI_DRIVER_SWRAST=y
BR2_PACKAGE_MESA3D_DRI_DRIVER_I915=y
BR2_PACKAGE_MESA3D_DRI_DRIVER_I965=y
BR2_PACKAGE_MESA3D_DRI_DRIVER_NOUVEAU=y
BR2_PACKAGE_MESA3D_DRI_DRIVER_RADEON=y
BR2_PACKAGE_MESA3D_OPENGL_ES=y
BR2_PACKAGE_QT5=y
BR2_PACKAGE_QT5BASE_LICENSE_APPROVED=y
BR2_PACKAGE_QT5BASE_EXAMPLES=y
BR2_PACKAGE_QT5BASE_CONCURRENT=y
BR2_PACKAGE_QT5BASE_SQLITE_SYSTEM=y
BR2_PACKAGE_QT5BASE_FONTCONFIG=y
BR2_PACKAGE_QT5BASE_GIF=y
BR2_PACKAGE_QT5BASE_JPEG=y
BR2_PACKAGE_QT5BASE_PNG=y
BR2_PACKAGE_QT5BASE_TSLIB=y
BR2_PACKAGE_QT5CANVAS3D=y
BR2_PACKAGE_QT5ENGINIO=y
BR2_PACKAGE_QT5GRAPHICALEFFECTS=y
BR2_PACKAGE_QT5IMAGEFORMATS=y
BR2_PACKAGE_QT5LOCATION=y
BR2_PACKAGE_QT5MULTIMEDIA=y
BR2_PACKAGE_QT5QUICKCONTROLS=y
BR2_PACKAGE_QT5SENSORS=y
BR2_PACKAGE_QT5SVG=y
BR2_PACKAGE_QT5WEBCHANNEL=y
BR2_PACKAGE_QT53D=y
BR2_PACKAGE_QT5QUICKCONTROLS2=y
BR2_PACKAGE_QT5SERIALBUS=y
BR2_PACKAGE_QT5SCRIPT=y
BR2_PACKAGE_QT5WEBKIT=y
BR2_PACKAGE_GPTFDISK=y
BR2_PACKAGE_GPTFDISK_GDISK=y
BR2_PACKAGE_GPTFDISK_SGDISK=y
BR2_PACKAGE_ALSA_LIB=y
BR2_PACKAGE_OPENSSL_BIN=y
BR2_PACKAGE_LIBDRM_AMDGPU=y
BR2_PACKAGE_LIBVA=y
BR2_PACKAGE_OPENCV=y
BR2_PACKAGE_OPENCV_LIB_GPU=y
BR2_PACKAGE_OPENCV_LIB_NONFREE=y
BR2_PACKAGE_OPENCV_WITH_FFMPEG=y
BR2_PACKAGE_OPENCV_WITH_JASPER=y
BR2_PACKAGE_OPENCV_WITH_JPEG=y
BR2_PACKAGE_OPENCV_WITH_PNG=y
BR2_PACKAGE_OPENCV_WITH_TIFF=y
BR2_PACKAGE_OPENCV_WITH_V4L=y
BR2_PACKAGE_OPENCV_INSTALL_DATA=y
BR2_PACKAGE_LINUX_PAM=y
BR2_PACKAGE_PCRE_32=y
BR2_PACKAGE_PCRE_UCP=y
BR2_PACKAGE_OPKG=y
BR2_PACKAGE_OPKG_GPG_SIGN=y
BR2_PACKAGE_DIALOG=y
BR2_PACKAGE_FILE=y
BR2_PACKAGE_GNUPG_AES=y
BR2_PACKAGE_GNUPG_RSA=y
BR2_PACKAGE_GNUPG_GPGV=y
BR2_PACKAGE_GNUPG_GPGSPLIT=y
BR2_PACKAGE_UTIL_LINUX_LIBMOUNT=y
BR2_PACKAGE_UTIL_LINUX_LSBLK=y
BR2_TARGET_ROOTFS_EXT2=y
# BR2_TARGET_ROOTFS_TAR is not set
```

## configs/tdc_etlmd_v2_initramfs_defconfig
```kconfig
BR2_x86_64=y
BR2_x86_core2=y
BR2_JLEVEL=4
BR2_CCACHE=y
BR2_TOOLCHAIN_BUILDROOT_VENDOR="etlmdv2"
BR2_PACKAGE_HOST_LINUX_HEADERS_CUSTOM_4_4=y
BR2_TOOLCHAIN_BUILDROOT_GLIBC=y
BR2_GLIBC_VERSION_2_24=y
BR2_BINUTILS_VERSION_2_27_X=y
BR2_GCC_VERSION_6_X=y
BR2_TOOLCHAIN_BUILDROOT_CXX=y
BR2_GCC_ENABLE_LTO=y
BR2_GCC_ENABLE_OPENMP=y
BR2_TARGET_GENERIC_HOSTNAME="etlmdv2"
BR2_TARGET_GENERIC_ISSUE="Welcome to ETLMD v2"
BR2_TARGET_GENERIC_GETTY_PORT="tty1"
BR2_SYSTEM_DHCP="eth0"
BR2_TARGET_TZ_INFO=y
BR2_ROOTFS_OVERLAY="board/tdc/etlmd-v2/initramfs_overlay"
BR2_LINUX_KERNEL=y
BR2_LINUX_KERNEL_CUSTOM_VERSION=y
BR2_LINUX_KERNEL_CUSTOM_VERSION_VALUE="4.4.24"
BR2_LINUX_KERNEL_USE_CUSTOM_CONFIG=y
BR2_LINUX_KERNEL_CUSTOM_CONFIG_FILE="board/tdc/etlmd-v2/linux-4.4.config"
BR2_PACKAGE_BUSYBOX_CONFIG="board/tdc/common/busybox.config"
BR2_PACKAGE_BUSYBOX_WATCHDOG=y
BR2_PACKAGE_BZIP2=y
BR2_PACKAGE_ACPID=y
BR2_PACKAGE_SQLITE=y
BR2_PACKAGE_LIBPCIACCESS=y
BR2_PACKAGE_LIBPTHREAD_STUBS=y
BR2_PACKAGE_LIBPTHSEM=y
BR2_PACKAGE_LIBPTHSEM_COMPAT=y
BR2_PACKAGE_OPKG=y
BR2_PACKAGE_OPKG_GPG_SIGN=y
BR2_PACKAGE_GNUPG_AES=y
BR2_PACKAGE_GNUPG_RSA=y
BR2_PACKAGE_GNUPG_GPGV=y
BR2_PACKAGE_GNUPG_GPGSPLIT=y
BR2_TARGET_ROOTFS_CPIO=y
BR2_TARGET_ROOTFS_CPIO_GZIP=y
BR2_PACKAGE_HOST_E2FSPROGS=y
BR2_PACKAGE_HOST_GENEXT2FS=y
```
