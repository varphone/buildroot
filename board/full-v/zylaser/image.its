## configs/tdc_hinvr_hi3520d_mini_defconfig
```kconfig
BR2_arm=y
BR2_cortex_a9=y
BR2_WGET="wget --passive-ftp -nd -t 3 --no-check-certificate --user=${WGET_USER} --password=${WGET_PASSWORD}"
BR2_STATIC_LIBS=y
BR2_GLOBAL_PATCH_DIR="board/tdc/hinvr-hi3520d/patches"
BR2_TOOLCHAIN_BUILDROOT_VENDOR="hinvr"
BR2_PACKAGE_HOST_LINUX_HEADERS_CUSTOM_3_0=y
BR2_TOOLCHAIN_BUILDROOT_LOCALE=y
BR2_TOOLCHAIN_BUILDROOT_USE_SSP=y
# BR2_UCLIBC_INSTALL_UTILS is not set
BR2_BINUTILS_VERSION_2_31_X=y
BR2_TOOLCHAIN_BUILDROOT_CXX=y
BR2_GCC_ENABLE_LTO=y
BR2_PACKAGE_HOST_GDB=y
BR2_GDB_VERSION_8_1=y
BR2_TARGET_CFLAGS_EXTRA="-mno-unaligned-access"
BR2_TARGET_GENERIC_HOSTNAME="hinvr-hi3520d"
BR2_TARGET_GENERIC_ISSUE="Welcome to HiNVR (Hi3520D)"
BR2_ROOTFS_DEVICE_TABLE="board/tdc/hinvr-hi3520d/device_table.txt"
BR2_TARGET_GENERIC_GETTY_PORT="ttyAMA0"
# BR2_TARGET_GENERIC_REMOUNT_ROOTFS_RW is not set
BR2_SYSTEM_DHCP="eth0"
BR2_ENABLE_LOCALE_WHITELIST="C en_US zh_CN zh_HK zh_TW"
BR2_TARGET_TZ_INFO=y
BR2_TARGET_LOCALTIME="Asia/Shanghai"
BR2_ROOTFS_OVERLAY="board/tdc/hinvr-hi3520d/rootfs_overlay"
BR2_ROOTFS_POST_BUILD_SCRIPT="board/tdc/hinvr-hi3520d/pre-image.sh"
BR2_ROOTFS_POST_FAKEROOT_SCRIPT="board/tdc/hinvr-hi3520d/fakeroot.sh"
BR2_ROOTFS_POST_IMAGE_SCRIPT="board/tdc/hinvr-hi3520d/post-image.sh"
BR2_LINUX_KERNEL=y
BR2_LINUX_KERNEL_CUSTOM_TARBALL=y
BR2_LINUX_KERNEL_CUSTOM_TARBALL_LOCATION="https://10.0.2.2/cgit/rdst/linux-stable.git/snapshot/linux-stable-3.0.8-Hi3520D-V1.0.5.0-R2.tar.gz"
BR2_LINUX_KERNEL_PATCH="board/tdc/hinvr-hi3520d/patches/linux/3.0.8"
BR2_LINUX_KERNEL_USE_CUSTOM_CONFIG=y
BR2_LINUX_KERNEL_CUSTOM_CONFIG_FILE="board/tdc/hinvr-hi3520d/linux-3.0.8-mini.config"
BR2_LINUX_KERNEL_UIMAGE=y
BR2_LINUX_KERNEL_LZMA=y
BR2_PACKAGE_BUSYBOX_CONFIG="board/tdc/hinvr-hi3520d/busybox.config"
BR2_PACKAGE_BUSYBOX_WATCHDOG=y
BR2_PACKAGE_FFMPEG=y
BR2_PACKAGE_FFMPEG_GPL=y
BR2_PACKAGE_FFMPEG_NONFREE=y
# BR2_PACKAGE_FFMPEG_FFMPEG is not set
BR2_PACKAGE_FFMPEG_ENCODERS="aac,mp3,pcm_alaw,pcm_mulaw,pcm_s16be,pcm_s16le,pcm_s8,pcm_u8,pcm_u16be,pcm_u16le"
BR2_PACKAGE_FFMPEG_DECODERS="aac,mp3,pcm_alaw,pcm_mulaw,pcm_s16be,pcm_s16le,pcm_s8,pcm_u8,pcm_u16be,pcm_u16le"
BR2_PACKAGE_FFMPEG_MUXERS="mov,mp4"
BR2_PACKAGE_FFMPEG_DEMUXERS="mov,mp4"
BR2_PACKAGE_FFMPEG_PARSERS="aac,h264"
BR2_PACKAGE_FFMPEG_PROTOCOLS="file"
BR2_PACKAGE_FFMPEG_FILTERS=""
# BR2_PACKAGE_FFMPEG_INDEVS is not set
# BR2_PACKAGE_FFMPEG_OUTDEVS is not set
BR2_PACKAGE_GSTREAMER1=y
# BR2_PACKAGE_GSTREAMER1_PARSE is not set
# BR2_PACKAGE_GSTREAMER1_TRACE is not set
# BR2_PACKAGE_GSTREAMER1_GST_DEBUG is not set
# BR2_PACKAGE_GSTREAMER1_PLUGIN_REGISTRY is not set
# BR2_PACKAGE_GSTREAMER1_INSTALL_TOOLS is not set
BR2_PACKAGE_GST1_PLUGINS_BASE_PLUGIN_AUDIORATE=y
BR2_PACKAGE_GST1_PLUGINS_BASE_PLUGIN_AUDIOTESTSRC=y
BR2_PACKAGE_GST1_PLUGINS_BASE_PLUGIN_ENCODING=y
BR2_PACKAGE_GST1_PLUGINS_BASE_PLUGIN_VIDEOCONVERT=y
BR2_PACKAGE_GST1_PLUGINS_BASE_PLUGIN_GIO=y
BR2_PACKAGE_GST1_PLUGINS_BASE_PLUGIN_TCP=y
BR2_PACKAGE_GST1_PLUGINS_BASE_PLUGIN_VIDEOTESTSRC=y
BR2_PACKAGE_GST1_PLUGINS_BASE_PLUGIN_VIDEORATE=y
BR2_PACKAGE_GST1_PLUGINS_BASE_PLUGIN_OPUS=y
BR2_PACKAGE_GST1_PLUGINS_BASE_PLUGIN_PANGO=y
BR2_PACKAGE_GST1_PLUGINS_GOOD_JPEG=y
BR2_PACKAGE_GST1_PLUGINS_GOOD_PNG=y
BR2_PACKAGE_GST1_PLUGINS_GOOD_ZLIB=y
BR2_PACKAGE_GST1_PLUGINS_GOOD_PLUGIN_AUDIOPARSERS=y
BR2_PACKAGE_GST1_PLUGINS_GOOD_PLUGIN_DEINTERLACE=y
BR2_PACKAGE_GST1_PLUGINS_GOOD_PLUGIN_IMAGEFREEZE=y
BR2_PACKAGE_GST1_PLUGINS_GOOD_PLUGIN_MULTIFILE=y
BR2_PACKAGE_GST1_PLUGINS_GOOD_PLUGIN_MULTIPART=y
BR2_PACKAGE_GST1_PLUGINS_GOOD_PLUGIN_RTSP=y
BR2_PACKAGE_GST1_PLUGINS_GOOD_PLUGIN_VIDEOFILTER=y
BR2_PACKAGE_GST1_PLUGINS_GOOD_PLUGIN_VIDEOMIXER=y
BR2_PACKAGE_GST1_PLUGINS_BAD=y
BR2_PACKAGE_GST1_PLUGINS_BAD_PLUGIN_VIDEOPARSERS=y
BR2_PACKAGE_GST1_RTSP_SERVER=y
BR2_PACKAGE_MTD=y
# BR2_PACKAGE_MTD_FLASHCP is not set
# BR2_PACKAGE_MTD_FLASH_ERASE is not set
# BR2_PACKAGE_MTD_FLASH_LOCK is not set
# BR2_PACKAGE_MTD_FLASH_UNLOCK is not set
BR2_PACKAGE_MTD_MKFSJFFS2=y
# BR2_PACKAGE_MTD_MTD_DEBUG is not set
# BR2_PACKAGE_MTD_NANDDUMP is not set
# BR2_PACKAGE_MTD_NANDTEST is not set
# BR2_PACKAGE_MTD_NANDWRITE is not set
# BR2_PACKAGE_MTD_MTDINFO is not set
# BR2_PACKAGE_MTD_UBIATTACH is not set
# BR2_PACKAGE_MTD_UBICRC32 is not set
# BR2_PACKAGE_MTD_UBIDETACH is not set
# BR2_PACKAGE_MTD_UBIFORMAT is not set
# BR2_PACKAGE_MTD_UBIMKVOL is not set
# BR2_PACKAGE_MTD_UBINFO is not set
# BR2_PACKAGE_MTD_UBINIZE is not set
# BR2_PACKAGE_MTD_UBIRENAME is not set
# BR2_PACKAGE_MTD_UBIRMVOL is not set
# BR2_PACKAGE_MTD_UBIRSVOL is not set
# BR2_PACKAGE_MTD_UBIUPDATEVOL is not set
# BR2_PACKAGE_MTD_UBIBLOCK is not set
BR2_PACKAGE_QT5=y
BR2_PACKAGE_QT5_VERSION_5_9=y
BR2_PACKAGE_QT5BASE_GUI=y
BR2_PACKAGE_QT5BASE_WIDGETS=y
BR2_PACKAGE_QT5BASE_DEFAULT_QPA="linuxfb"
BR2_PACKAGE_QT5BASE_JPEG=y
BR2_PACKAGE_QT5BASE_PNG=y
BR2_PACKAGE_HISILICON=y
BR2_PACKAGE_HISILICON_PLATFORM_HI3520D=y
BR2_PACKAGE_HISILICON_SDK_VERSION_V1_0_5_0=y
BR2_PACKAGE_MPP_KO=y
BR2_PACKAGE_MPP_LIB=y
BR2_PACKAGE_REG_TOOLS=y
BR2_PACKAGE_REG_TOOLS_GPIO_I2C=y
BR2_PACKAGE_CAIRO_PNG=y
BR2_PACKAGE_JPEG_MPP_LIB=y
BR2_PACKAGE_LIVE555=y
BR2_PACKAGE_LIVE555_CUSTOM_TARBALL=y
BR2_PACKAGE_LIVE555_CUSTOM_TARBALL_LOCATION="https://github.com/varphone/live/archive/v2018.07.07.tar.gz"
BR2_PACKAGE_LIVE555_CUSTOM_TARBALL_STRIP_COMPONENTS=1
BR2_PACKAGE_AUGEAS=y
BR2_PACKAGE_TDC=y
BR2_PACKAGE_HINVR_QT=y
BR2_TARGET_ROOTFS_SQUASHFS=y
BR2_TARGET_ROOTFS_SQUASHFS4_XZ=y
BR2_TARGET_ROOTFS_TAR_XZ=y
BR2_TARGET_ROOTFS_UBI=y
BR2_TARGET_ROOTFS_UBI_SUBSIZE=2048
BR2_TARGET_ROOTFS_UBI_USE_CUSTOM_CONFIG=y
BR2_TARGET_ROOTFS_UBI_CUSTOM_CONFIG_FILE="board/tdc/hinvr-hi3520d/ubinize.cfg"
BR2_TARGET_ROOTFS_UBIFS_LEBSIZE=0x1f000
BR2_TARGET_ROOTFS_UBIFS_MAXLEBCNT=800
BR2_TARGET_ROOTFS_UBIFS_LZO=y
BR2_TARGET_ROOTFS_UBIFS_OPTS="-F"
BR2_TARGET_UBOOT=y
BR2_TARGET_UBOOT_BOARDNAME="hi3520d"
BR2_TARGET_UBOOT_CUSTOM_TARBALL=y
BR2_TARGET_UBOOT_CUSTOM_TARBALL_LOCATION="https://10.0.2.2/cgit/rdst/u-boot.git/snapshot/u-boot-2010.06-Hi3520D-V1.0.5.0-R1.tar.gz"
BR2_PACKAGE_HOST_CMAKE=y
BR2_PACKAGE_HOST_DOSFSTOOLS=y
BR2_PACKAGE_HOST_E2FSPROGS=y
BR2_PACKAGE_HOST_GENEXT2FS=y
BR2_PACKAGE_HOST_GENIMAGE=y
BR2_PACKAGE_HOST_MTD=y
BR2_PACKAGE_HOST_MTOOLS=y
BR2_PACKAGE_HOST_SQUASHFS=y
```

## configs/tdc_hivcap_v1_defconfig
```kconfig
BR2_arm=y
BR2_cortex_a9=y
BR2_ARM_ENABLE_VFP=y
BR2_ARM_EABI=y
BR2_WGET="wget --passive-ftp -nd -t 3 --no-check-certificate --user=${WGET_USER} --password=${WGET_PASSWORD}"
BR2_GLOBAL_PATCH_DIR="board/tdc/hivcap-v1/patches"
BR2_TOOLCHAIN_BUILDROOT_VENDOR="hivcapv1"
BR2_PACKAGE_HOST_LINUX_HEADERS_CUSTOM_3_0=y
BR2_TOOLCHAIN_BUILDROOT_LOCALE=y
BR2_PTHREAD_DEBUG=y
# BR2_UCLIBC_INSTALL_UTILS is not set
BR2_BINUTILS_VERSION_2_30_X=y
BR2_GCC_VERSION_7_X=y
BR2_TOOLCHAIN_BUILDROOT_CXX=y
BR2_GCC_ENABLE_LTO=y
BR2_PACKAGE_HOST_GDB=y
BR2_GDB_VERSION_8_0=y
BR2_TARGET_GENERIC_HOSTNAME="hivcap-v1"
BR2_TARGET_GENERIC_ISSUE="Welcome to HIVCAP-V1"
BR2_ROOTFS_DEVICE_TABLE="board/tdc/hivcap-v1/device_table.txt"
BR2_TARGET_GENERIC_GETTY_PORT="ttyAMA0"
# BR2_TARGET_GENERIC_REMOUNT_ROOTFS_RW is not set
BR2_SYSTEM_DHCP="eth0"
# BR2_ENABLE_LOCALE_PURGE is not set
BR2_TARGET_TZ_INFO=y
BR2_TARGET_LOCALTIME="Asia/Shanghai"
BR2_ROOTFS_OVERLAY="board/tdc/hivcap-v1/rootfs_overlay"
BR2_ROOTFS_POST_BUILD_SCRIPT="board/tdc/hivcap-v1/pre-image.sh"
BR2_ROOTFS_POST_FAKEROOT_SCRIPT="board/tdc/hivcap-v1/fakeroot.sh"
BR2_ROOTFS_POST_IMAGE_SCRIPT="board/tdc/hivcap-v1/post-image.sh"
BR2_LINUX_KERNEL=y
BR2_LINUX_KERNEL_CUSTOM_TARBALL=y
BR2_LINUX_KERNEL_CUSTOM_TARBALL_LOCATION="https://10.0.2.2/cgit/rdst/linux-stable.git/snapshot/linux-stable-3.0.8-Hi3531-V1.0.D.0-13.tar.gz"
BR2_LINUX_KERNEL_PATCH="board/tdc/hivcap-v1/patches/linux/3.0.8"
BR2_LINUX_KERNEL_USE_CUSTOM_CONFIG=y
BR2_LINUX_KERNEL_CUSTOM_CONFIG_FILE="board/tdc/hivcap-v1/linux-3.0.8.config"
BR2_LINUX_KERNEL_UIMAGE=y
BR2_LINUX_KERNEL_LZO=y
BR2_PACKAGE_BUSYBOX_CUSTOM_TARBALL=y
BR2_PACKAGE_BUSYBOX_CONFIG="board/tdc/hivcap-v1/busybox.config"
BR2_PACKAGE_BUSYBOX_WATCHDOG=y
BR2_PACKAGE_FFMPEG=y
BR2_PACKAGE_FFMPEG_GPL=y
BR2_PACKAGE_FFMPEG_NONFREE=y
# BR2_PACKAGE_FFMPEG_FFMPEG is not set
BR2_PACKAGE_FFMPEG_ENCODERS="aac,mp3,pcm_alaw,pcm_mulaw,pcm_s16be,pcm_s16le,pcm_s8,pcm_u8,pcm_u16be,pcm_u16le"
BR2_PACKAGE_FFMPEG_DECODERS="aac,mp3,pcm_alaw,pcm_mulaw,pcm_s16be,pcm_s16le,pcm_s8,pcm_u8,pcm_u16be,pcm_u16le"
BR2_PACKAGE_FFMPEG_MUXERS="mov,mp4"
BR2_PACKAGE_FFMPEG_DEMUXERS="mov,mp4"
BR2_PACKAGE_FFMPEG_PARSERS="aac,h264"
BR2_PACKAGE_FFMPEG_PROTOCOLS="file"
BR2_PACKAGE_FFMPEG_FILTERS=""
# BR2_PACKAGE_FFMPEG_INDEVS is not set
# BR2_PACKAGE_FFMPEG_OUTDEVS is not set
BR2_PACKAGE_DOSFSTOOLS=y
BR2_PACKAGE_DOSFSTOOLS_FATLABEL=y
BR2_PACKAGE_DOSFSTOOLS_FSCK_FAT=y
BR2_PACKAGE_DOSFSTOOLS_MKFS_FAT=y
BR2_PACKAGE_E2FSPROGS=y
BR2_PACKAGE_E2FSPROGS_RESIZE2FS=y
BR2_PACKAGE_MTD=y
# BR2_PACKAGE_MTD_FLASHCP is not set
# BR2_PACKAGE_MTD_FLASH_LOCK is not set
# BR2_PACKAGE_MTD_FLASH_UNLOCK is not set
# BR2_PACKAGE_MTD_MTD_DEBUG is not set
BR2_PACKAGE_MTD_MTDPART=y
# BR2_PACKAGE_MTD_NANDTEST is not set
BR2_PACKAGE_TENSEN=y
BR2_PACKAGE_HISILICON=y
BR2_PACKAGE_HISILICON_PLATFORM_HI3531=y
BR2_PACKAGE_MPP_KO=y
BR2_PACKAGE_MPP_LIB=y
BR2_PACKAGE_REG_TOOLS=y
BR2_PACKAGE_REG_TOOLS_GPIO_I2C=y
BR2_PACKAGE_ALSA_LIB=y
BR2_PACKAGE_CAIRO=y
BR2_PACKAGE_CAIRO_PNG=y
BR2_PACKAGE_JPEG=y
BR2_PACKAGE_JPEG_MPP_LIB=y
BR2_PACKAGE_TDC=y
BR2_PACKAGE_IPTABLES=y
BR2_PACKAGE_OPENSSH=y
BR2_PACKAGE_MONIT=y
BR2_PACKAGE_UTIL_LINUX_BINARIES=y
BR2_PACKAGE_UTIL_LINUX_LSBLK=y
# BR2_TARGET_ROOTFS_TAR is not set
BR2_TARGET_ROOTFS_UBI=y
BR2_TARGET_ROOTFS_UBI_SUBSIZE=2048
BR2_TARGET_ROOTFS_UBI_USE_CUSTOM_CONFIG=y
BR2_TARGET_ROOTFS_UBI_CUSTOM_CONFIG_FILE="board/tdc/hivcap-v1/ubinize.cfg"
BR2_TARGET_ROOTFS_UBIFS_LEBSIZE=0x1f000
BR2_TARGET_ROOTFS_UBIFS_MAXLEBCNT=800
BR2_TARGET_ROOTFS_UBIFS_LZO=y
BR2_TARGET_ROOTFS_UBIFS_OPTS="-F"
BR2_TARGET_UBOOT=y
BR2_TARGET_UBOOT_BOARDNAME="godnet"
BR2_TARGET_UBOOT_CUSTOM_TARBALL=y
BR2_TARGET_UBOOT_CUSTOM_TARBALL_LOCATION="https://10.0.2.2/cgit/rdst/u-boot.git/snapshot/u-boot-2010.06-Hi3531-V1.0.D.0-3.tar.bz2"
BR2_PACKAGE_HOST_GENIMAGE=y
BR2_PACKAGE_HOST_MTOOLS=y
```

## configs/tdc_jycz2p_defconfig
```kconfig
BR2_arm=y
BR2_cortex_a9=y
BR2_ARM_ENABLE_NEON=y
BR2_ARM_ENABLE_VFP=y
BR2_ARM_FPU_VFPV3=y
BR2_WGET="wget --passive-ftp -nd -t 3 --no-check-certificate --user=${WGET_USER} --password=${WGET_PASSWORD}"
BR2_SHARED_STATIC_LIBS=y
BR2_GLOBAL_PATCH_DIR="board/tdc/jycz2p/patches"
BR2_TOOLCHAIN_BUILDROOT_GLIBC=y
BR2_PACKAGE_HOST_LINUX_HEADERS_CUSTOM_4_14=y
BR2_BINUTILS_VERSION_2_32_X=y
BR2_GCC_VERSION_9_X=y
BR2_TOOLCHAIN_BUILDROOT_CXX=y
BR2_GCC_ENABLE_LTO=y
BR2_PACKAGE_HOST_GDB=y
BR2_GDB_VERSION_8_3=y
BR2_ROOTFS_DEVICE_CREATION_DYNAMIC_EUDEV=y
BR2_TARGET_GENERIC_GETTY_PORT="ttymxc1"
BR2_LINUX_KERNEL=y
BR2_LINUX_KERNEL_CUSTOM_TARBALL=y
BR2_LINUX_KERNEL_CUSTOM_TARBALL_LOCATION="https://10.0.2.2/cgit/rdst/linux-stable.git/snapshot/linux-stable-4.14.134-jycz2p-r1.tar.gz"
BR2_LINUX_KERNEL_USE_CUSTOM_CONFIG=y
BR2_LINUX_KERNEL_CUSTOM_CONFIG_FILE="board/tdc/jycz2p/linux-4.14.134-phy.config"
BR2_LINUX_KERNEL_LZ4=y
BR2_LINUX_KERNEL_DTS_SUPPORT=y
BR2_LINUX_KERNEL_INTREE_DTS_NAME="imx6q-jycz2p-nand"
BR2_LINUX_KERNEL_INSTALL_TARGET=y
BR2_LINUX_KERNEL_NEEDS_HOST_OPENSSL=y
BR2_PACKAGE_F2FS_TOOLS=y
BR2_PACKAGE_GLMARK2=y
BR2_PACKAGE_KMSCUBE=y
BR2_PACKAGE_FB_TEST_APP=y
BR2_PACKAGE_MESA3D=y
BR2_PACKAGE_MESA3D_GALLIUM_DRIVER_ETNAVIV=y
BR2_PACKAGE_MESA3D_GALLIUM_DRIVER_KMSRO=y
BR2_PACKAGE_MESA3D_OSMESA_CLASSIC=y
BR2_PACKAGE_MESA3D_OPENGL_ES=y
BR2_PACKAGE_FREESCALE_IMX=y
BR2_PACKAGE_FREESCALE_IMX_PLATFORM_IMX6Q=y
BR2_PACKAGE_FIRMWARE_IMX=y
BR2_PACKAGE_SQLITE=y
BR2_PACKAGE_SQLITE_ENABLE_COLUMN_METADATA=y
BR2_PACKAGE_FREETYPE=y
BR2_PACKAGE_HARFBUZZ=y
BR2_PACKAGE_LIBDRM_INSTALL_TESTS=y
BR2_PACKAGE_LIBV4L=y
BR2_PACKAGE_LIBV4L_UTILS=y
BR2_PACKAGE_PCRE2=y
BR2_PACKAGE_PCRE2_16=y
BR2_TARGET_ROOTFS_SQUASHFS=y
BR2_TARGET_ROOTFS_SQUASHFS4_LZ4=y
BR2_TARGET_BAREBOX=y
BR2_TARGET_BAREBOX_CUSTOM_TARBALL=y
BR2_TARGET_BAREBOX_CUSTOM_TARBALL_LOCATION="https://10.0.2.2/cgit/rdst/barebox.git/snapshot/barebox-2017.12.0-phy4.tar.gz"
BR2_TARGET_BAREBOX_USE_CUSTOM_CONFIG=y
BR2_TARGET_BAREBOX_CUSTOM_CONFIG_FILE="board/tdc/jycz2p/barebox-2017.12.0-phy.config"
BR2_TARGET_BAREBOX_IMAGE_FILE="images/barebox-phytec-phycore-imx6q-som-nand-1gib.img"
BR2_PACKAGE_HOST_UTIL_LINUX=y
```
