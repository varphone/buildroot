## configs/tdc_ppmd_v1_defconfig
```kconfig
BR2_arm=y
BR2_cortex_a9=y
BR2_ARM_ENABLE_VFP=y
BR2_ARM_EABI=y
BR2_WGET="wget --passive-ftp -nd -t 3 --no-check-certificate --user=${WGET_USER} --password=${WGET_PASSWORD}"
BR2_GLOBAL_PATCH_DIR="board/tdc/ppmd-v1/patches"
BR2_TOOLCHAIN_BUILDROOT_VENDOR="hi3531"
BR2_PACKAGE_HOST_LINUX_HEADERS_CUSTOM_3_0=y
BR2_TOOLCHAIN_BUILDROOT_INET_RPC=y
BR2_TOOLCHAIN_BUILDROOT_LOCALE=y
BR2_PTHREADS=y
BR2_PTHREAD_DEBUG=y
BR2_TOOLCHAIN_BUILDROOT_USE_SSP=y
BR2_BINUTILS_VERSION_2_27_X=y
BR2_GCC_VERSION_4_9_X=y
BR2_TOOLCHAIN_BUILDROOT_CXX=y
BR2_GCC_ENABLE_LTO=y
BR2_GCC_ENABLE_OPENMP=y
BR2_GCC_ENABLE_GRAPHITE=y
BR2_TARGET_GENERIC_HOSTNAME="rdst"
BR2_TARGET_GENERIC_ISSUE="Welcome to PPMD - V1"
BR2_ROOTFS_DEVICE_TABLE="board/tdc/ppmd-v1/device_table.txt"
BR2_TARGET_GENERIC_GETTY_PORT="ttyAMA0"
# BR2_TARGET_GENERIC_REMOUNT_ROOTFS_RW is not set
BR2_SYSTEM_DHCP="eth0"
BR2_GENERATE_LOCALE="en_US zh_CN zh_TW"
BR2_TARGET_TZ_INFO=y
BR2_TARGET_LOCALTIME="Asia/Shanghai"
BR2_ROOTFS_OVERLAY="board/tdc/ppmd-v1/rootfs_overlay"
BR2_ROOTFS_POST_BUILD_SCRIPT="board/tdc/ppmd-v1/pre-image.sh"
BR2_ROOTFS_POST_FAKEROOT_SCRIPT="board/tdc/ppmd-v1/fakeroot.sh"
BR2_ROOTFS_POST_IMAGE_SCRIPT="board/tdc/ppmd-v1/post-image.sh"
BR2_LINUX_KERNEL=y
BR2_LINUX_KERNEL_CUSTOM_TARBALL=y
BR2_LINUX_KERNEL_CUSTOM_TARBALL_LOCATION="https://10.0.2.2/cgit/rdst/linux-stable.git/snapshot/linux-stable-3.0.8-Hi3531-V1.0.D.0-2.tar.bz2"
BR2_LINUX_KERNEL_PATCH="board/tdc/ppmd-v1/patches/linux/3.0.8"
BR2_LINUX_KERNEL_USE_CUSTOM_CONFIG=y
BR2_LINUX_KERNEL_CUSTOM_CONFIG_FILE="board/tdc/ppmd-v1/linux-3.0.8.config"
BR2_LINUX_KERNEL_UIMAGE=y
BR2_LINUX_KERNEL_XZ=y
BR2_PACKAGE_BUSYBOX_CONFIG="board/tdc/common/busybox.config"
BR2_PACKAGE_ALSA_UTILS=y
BR2_PACKAGE_ALSA_UTILS_AMIXER=y
BR2_PACKAGE_ALSA_UTILS_APLAY=y
BR2_PACKAGE_JQ=y
BR2_PACKAGE_DOSFSTOOLS=y
BR2_PACKAGE_DOSFSTOOLS_FATLABEL=y
BR2_PACKAGE_DOSFSTOOLS_FSCK_FAT=y
BR2_PACKAGE_DOSFSTOOLS_MKFS_FAT=y
BR2_PACKAGE_F2FS_TOOLS=y
BR2_PACKAGE_MTD=y
BR2_PACKAGE_HISILICON=y
BR2_PACKAGE_HISILICON_PLATFORM_HI3531=y
BR2_PACKAGE_MPP_KO=y
BR2_PACKAGE_MPP_LIB=y
BR2_PACKAGE_REG_TOOLS=y
BR2_PACKAGE_REG_TOOLS_GPIO_I2C=y
BR2_PACKAGE_EXPAT=y
BR2_PACKAGE_LIBINI=y
BR2_PACKAGE_TDC=y
BR2_PACKAGE_PPMD_3531=y
BR2_PACKAGE_PPMD_3531_CUSTOM_VERSION=y
BR2_PACKAGE_XPR=y
BR2_PACKAGE_XPR_CUSTOM_VERSION=y
BR2_PACKAGE_OPENSSH=y
BR2_PACKAGE_OPKG=y
BR2_PACKAGE_OPKG_GPG_SIGN=y
BR2_PACKAGE_GNUPG_AES=y
BR2_PACKAGE_GNUPG_RSA=y
BR2_PACKAGE_GNUPG_GPGV=y
BR2_PACKAGE_GNUPG_GPGSPLIT=y
BR2_PACKAGE_MONIT=y
BR2_PACKAGE_UTIL_LINUX_BINARIES=y
BR2_TARGET_ROOTFS_CRAMFS=y
BR2_TARGET_ROOTFS_SQUASHFS=y
BR2_TARGET_ROOTFS_SQUASHFS4_XZ=y
# BR2_TARGET_ROOTFS_TAR is not set
BR2_PACKAGE_HOST_MKE2IMG=y
```

## configs/zylaser_defconfig
```kconfig
BR2_arm=y
BR2_cortex_a9=y
BR2_ARM_ENABLE_NEON=y
BR2_ARM_ENABLE_VFP=y
BR2_PIC_PIE=y
BR2_PACKAGE_HOST_LINUX_HEADERS_CUSTOM_5_4=y
BR2_TOOLCHAIN_BUILDROOT_LOCALE=y
BR2_PTHREAD_DEBUG=y
BR2_TOOLCHAIN_BUILDROOT_USE_SSP=y
BR2_BINUTILS_VERSION_2_34_X=y
BR2_GCC_VERSION_10_X=y
BR2_TOOLCHAIN_BUILDROOT_CXX=y
BR2_GCC_ENABLE_LTO=y
BR2_GCC_ENABLE_OPENMP=y
BR2_PACKAGE_HOST_GDB=y
BR2_GDB_VERSION_8_3=y
BR2_ROOTFS_DEVICE_CREATION_DYNAMIC_EUDEV=y
BR2_ROOTFS_DEVICE_TABLE="board/full-v/zylaser/device_table.txt"
BR2_TARGET_GENERIC_ROOT_PASSWD="root"
BR2_TARGET_TZ_INFO=y
BR2_TARGET_LOCALTIME="Asia/Shanghai"
BR2_ROOTFS_OVERLAY="board/full-v/zylaser/rootfs_overlay"
BR2_ROOTFS_POST_BUILD_SCRIPT="board/full-v/zylaser/pre-image.sh"
BR2_ROOTFS_POST_IMAGE_SCRIPT="board/full-v/zylaser/post-image.sh"
BR2_LINUX_KERNEL=y
BR2_LINUX_KERNEL_CUSTOM_TARBALL=y
BR2_LINUX_KERNEL_CUSTOM_TARBALL_LOCATION="https://github.com/Xilinx/linux-xlnx/archive/xilinx-v2020.1.tar.gz"
BR2_LINUX_KERNEL_USE_CUSTOM_CONFIG=y
BR2_LINUX_KERNEL_CUSTOM_CONFIG_FILE="board/full-v/zylaser/linux-5.4.config"
BR2_LINUX_KERNEL_DTS_SUPPORT=y
BR2_LINUX_KERNEL_INTREE_DTS_NAME="zynq-zylaser"
BR2_PACKAGE_BUSYBOX_CONFIG="board/full-v/zylaser/busybox.config"
BR2_PACKAGE_ZYLASER_FIRMWARE=y
BR2_PACKAGE_IPERF3=y
BR2_PACKAGE_OPENSSH=y
BR2_TARGET_ROOTFS_CPIO=y
BR2_TARGET_ROOTFS_CPIO_GZIP=y
BR2_TARGET_ROOTFS_CPIO_UIMAGE=y
BR2_TARGET_ROOTFS_EXT2=y
BR2_TARGET_ROOTFS_EXT2_4=y
BR2_TARGET_ROOTFS_EXT2_SIZE="128M"
BR2_TARGET_UBOOT=y
BR2_TARGET_UBOOT_BUILD_SYSTEM_KCONFIG=y
BR2_TARGET_UBOOT_CUSTOM_TARBALL=y
BR2_TARGET_UBOOT_CUSTOM_TARBALL_LOCATION="https://github.com/varphone/u-boot/archive/v2020.01-zylaser-r1.tar.gz"
BR2_TARGET_UBOOT_BOARD_DEFCONFIG="zylaser"
BR2_TARGET_UBOOT_NEEDS_DTC=y
BR2_TARGET_UBOOT_NEEDS_OPENSSL=y
BR2_TARGET_UBOOT_FORMAT_IMG=y
BR2_TARGET_UBOOT_FORMAT_ELF=y
BR2_TARGET_UBOOT_FORMAT_CUSTOM=y
BR2_TARGET_UBOOT_FORMAT_CUSTOM_NAME="u-boot.elf"
BR2_TARGET_ZYNQ_FSBL=y
BR2_PACKAGE_HOST_BOOTGEN=y
BR2_PACKAGE_HOST_DOSFSTOOLS=y
BR2_PACKAGE_HOST_GENIMAGE=y
BR2_PACKAGE_HOST_MTOOLS=y
BR2_PACKAGE_HOST_UBOOT_TOOLS_FIT_SUPPORT=y
BR2_PACKAGE_HOST_UBOOT_TOOLS_FIT_SIGNATURE_SUPPORT=y
```

## package/amlogic-utils/Config.in.host
```kconfig
config BR2_PACKAGE_HOST_AMLOGIC_UTILS
	bool "host amlogic-utils"
	help
	  This package contains the prebuilt binary and
	  some open source tools for amlogic boards.
```

## package/arm-gpu-mali/Config.in
```kconfig
comment "arm-gpu-mali needs a glibc toolchain with armhf enabled"
	depends on BR2_arm
	depends on !BR2_TOOLCHAIN_USES_GLIBC || !BR2_ARM_EABIHF

comment "arm-gpu-mali needs a glibc toolchain"
	depends on BR2_aarch64
	depends on !BR2_TOOLCHAIN_USES_GLIBC

config BR2_PACKAGE_ARM_GPU_MALI
	bool "arm-gpu-mali"
	# Pre-built binaries only available for ARM EABIhf
	depends on (BR2_arm && BR2_ARM_EABIHF) || BR2_aarch64
	# Library binaries are linked against libc.so.6
	depends on BR2_TOOLCHAIN_USES_GLIBC
	select BR2_PACKAGE_HAS_LIBEGL
	select BR2_PACKAGE_HAS_LIBGLES
	help
	  Userspace libraries for Arm Mali GPU on mulitple platforms

	  It contains libraries and headers for EGL, GLES, OpenCV, OpenVG, etc.

	  This library is provided by Vendor as-is and doesn't have
	  an upstream.

if BR2_PACKAGE_ARM_GPU_MALI

choice
        prompt "Hardware Codename"

config BR2_PACKAGE_ARM_GPU_MALI_HWCN_DVALIN
	bool "dvalin"

config BR2_PACKAGE_ARM_GPU_MALI_HWCN_GONDUL
	bool "gondul"

config BR2_PACKAGE_ARM_GPU_MALI_HWCN_M540
	bool "m450"

endchoice

config BR2_PACKAGE_ARM_GPU_MALI_HWCN
	string
	default "dvalin" if BR2_PACKAGE_ARM_GPU_MALI_HWCN_DVALIN
	default "gondul" if BR2_PACKAGE_ARM_GPU_MALI_HWCN_GONDUL
	default "m450" if BR2_PACKAGE_ARM_GPU_MALI_HWCN_M450

choice
        prompt "Hardware Version"

config BR2_PACKAGE_ARM_GPU_MALI_HWVER_R7P0
	bool "r7p0"

config BR2_PACKAGE_ARM_GPU_MALI_HWVER_R12P0
	bool "r12p0"

endchoice

config BR2_PACKAGE_ARM_GPU_MALI_HWVER
	string
	default "r7p0" if BR2_PACKAGE_ARM_GPU_MALI_HWVER_R7P0
	default "r12p0" if BR2_PACKAGE_ARM_GPU_MALI_HWVER_R12P0

choice
	prompt "Target"
	help
	  There are two versions of this library: one for
	  direct framebuffer access, one for X11 rendering.
	  Choose here which version to install.

config BR2_PACKAGE_ARM_GPU_MALI_TARGET_DUMMY
	bool "Dummy"

config BR2_PACKAGE_ARM_GPU_MALI_TARGET_FBDEV
	bool "Framebuffer"

config BR2_PACKAGE_ARM_GPU_MALI_TARGET_WAYLAND
	bool "Wayland"
	select BR2_PACKAGE_LIBDRM
	select BR2_PACKAGE_WAYLAND
	select BR2_PACKAGE_HAS_LIBEGL_WAYLAND

config BR2_PACKAGE_ARM_GPU_MALI_TARGET_X11
	bool "X11"
	depends on BR2_PACKAGE_XORG7
	select BR2_PACKAGE_XLIB_LIBXDAMAGE
	select BR2_PACKAGE_XLIB_LIBXEXT
	select BR2_PACKAGE_XLIB_LIBXFIXES

comment "X11 backend needs Xorg package"
	depends on !BR2_PACKAGE_XORG7

endchoice

config BR2_PACKAGE_ARM_GPU_MALI_TARGET
	string
	default "dummy" if BR2_PACKAGE_ARM_GPU_MALI_TARGET_DUMMY
	default "fbdev" if BR2_PACKAGE_ARM_GPU_MALI_TARGET_FBDEV
	default "wayland" if BR2_PACKAGE_ARM_GPU_MALI_TARGET_WAYLAND
	default "x11" if BR2_PACKAGE_ARM_GPU_MALI_TARGET_X11

choice
        prompt "Vendor"

config BR2_PACKAGE_ARM_GPU_MALI_VENDOR_AMLOGIC
	bool "Amlogic"

endchoice

config BR2_PACKAGE_ARM_GPU_MALI_VENDOR
	string
	default "amlogic" if BR2_PACKAGE_ARM_GPU_MALI_VENDOR_AMLOGIC

config BR2_PACKAGE_PROVIDES_LIBEGL
	default "arm-gpu-mali"

config BR2_PACKAGE_PROVIDES_LIBGLES
	default "arm-gpu-mali"

endif
```

## package/bootgen/Config.in.host
```kconfig
config BR2_PACKAGE_HOST_BOOTGEN
	bool "host bootgen"
	help
	  Bootgen for Xilinx SoC devices.

	  https://github.com/Xilinx/bootgen
```

## package/droid-sans/Config.in
```kconfig
config BR2_PACKAGE_DROID_SANS
	bool "Droid Sans fonts"
	help
	  Droid Sans is a humanist sans serif typeface designed by
	  Steve Matteson, Type Director of Ascender Corp. 

	  http://www.droidfonts.com

if BR2_PACKAGE_DROID_SANS

config BR2_PACKAGE_DROID_SANS_REGULAR
	bool "regular fonts"
	default y

config BR2_PACKAGE_DROID_SANS_BOLD
	bool "bold fonts"
	default y

config BR2_PACKAGE_DROID_SANS_FALLBACK_FULL
	bool "fallback full fonts"
	default y

endif
```

## package/freescale-imx/firmware-imx-3.0.35-4.0.0/Config.in
```kconfig
config BR2_PACKAGE_FIRMWARE_IMX_3_0_35_4_0_0
	bool "firmware-imx-3.0.35-4.0.0"
	depends on BR2_arm # Only relevant for i.MX
	help
	  Firmware blobs for the Freescale i.MX SoCs.

	  It contains blobs for SDMA and VPU.

	  This library is provided by Freescale as-is and doesn't have
	  an upstream.
```

## package/freescale-imx/imx-gpu-viv-bin-3.0.35-4.0.0/Config.in
```kconfig
config BR2_PACKAGE_IMX_GPU_VIV_BIN_3_0_35_4_0_0
	bool "imx-gpu-viv-bin-3.0.35-4.0.0"
	select BR2_PACKAGE_HAS_LIBEGL
	select BR2_PACKAGE_HAS_LIBGLES
	select BR2_PACKAGE_HAS_LIBOPENVG
	help
	  GPU prebuilt libaries for phyFLEX.

if BR2_PACKAGE_IMX_GPU_VIV_BIN_3_0_35_4_0_0

config BR2_PACKAGE_PROVIDES_LIBEGL
	default "imx-gpu-viv-bin-3.0.35-4.0.0"

config BR2_PACKAGE_PROVIDES_LIBGLES
	default "imx-gpu-viv-bin-3.0.35-4.0.0"

config BR2_PACKAGE_PROVIDES_LIBOPENVG
	default "imx-gpu-viv-bin-3.0.35-4.0.0"

endif
```

## package/freescale-imx/imx-lib-3.0.35-4.0.0/Config.in
```kconfig
comment "imx-lib-3.0.35 needs an imx-specific Linux kernel to be built"
	depends on BR2_arm && !BR2_LINUX_KERNEL

config BR2_PACKAGE_IMX_LIB_3_0_35_4_0_0
	bool "imx-lib-3.0.35-4.0.0"
	depends on BR2_LINUX_KERNEL
	depends on BR2_arm # Only relevant for i.MX
	help
	  Library of userspace helpers specific for the Freescale i.MX
	  platform. It wraps the kernel interfaces for some i.MX platform
	  specific drivers. It requires a kernel that includes the i.MX
	  specific headers to be built.

	  This library is provided by Freescale as-is and doesn't have
	  an upstream.
```

## package/gcc-linaro-aarch64-none-elf/Config.in.host
```kconfig
config BR2_PACKAGE_HOST_GCC_LINARO_AARCH64_NONE_ELF
	bool "host gcc-linaro-aarch64-none-elf toolchain"
	depends on BR2_aarch64 || BR2_arm
	help
	  This package contains the linaro aarch64-none-elf gcc toolchain.
```

## package/gcc-linaro-arm-none-eabi/Config.in.host
```kconfig
config BR2_PACKAGE_HOST_GCC_LINARO_ARM_NONE_EABI
	bool "host gcc-linaro-arm-none-eabi toolchain"
	depends on BR2_aarch64 || BR2_arm
	help
	  This package contains the linaro arm-none-eabi gcc toolchain.
```

## package/hisilicon/Config.in
```kconfig
config BR2_PACKAGE_HISILICON
	bool "hisilicon"
	help
	  Packages for the Hi3XXX platforms.

if BR2_PACKAGE_HISILICON

choice
        prompt "Chipset"

config BR2_PACKAGE_HISILICON_CHIP_HI3516DV300
	bool "hi3516dv300"

config BR2_PACKAGE_HISILICON_CHIP_HI3531DV100
	bool "hi3531dv100"

config BR2_PACKAGE_HISILICON_CHIP_HI3559AV100
	bool "hi3559av100"

endchoice

config BR2_PACKAGE_HISILICON_CHIP
	string
	default "hi3516dv300" if BR2_PACKAGE_HISILICON_CHIP_HI3516DV300
	default "hi3531dv100" if BR2_PACKAGE_HISILICON_CHIP_HI3531DV100
	default "hi3559av100" if BR2_PACKAGE_HISILICON_CHIP_HI3559AV100

choice
        prompt "CPU Type"
	depends on BR2_PACKAGE_HISILICON_CHIP_HI3559AV100

config BR2_PACKAGE_HISILICON_CPU_TYPE_BIG_LITTLE
        bool "big-little"

config BR2_PACKAGE_HISILICON_CPU_TYPE_MULTI_CORE
        bool "multi-core"

endchoice

config BR2_PACKAGE_HISILICON_CPU_TYPE
        string
	depends on BR2_PACKAGE_HISILICON_CHIP_HI3559AV100
        default "big-little" if BR2_PACKAGE_HISILICON_CPU_TYPE_BIG_LITTLE
        default "multi-core" if BR2_PACKAGE_HISILICON_CPU_TYPE_MULTI_CORE

choice
        prompt "Kernel"

config BR2_PACKAGE_HISILICON_KERNEL_LINUX
        bool "linux"

config BR2_PACKAGE_HISILICON_KERNEL_LITEOS
        bool "liteos"

endchoice

config BR2_PACKAGE_HISILICON_KERNEL
        string
        default "linux" if BR2_PACKAGE_HISILICON_KERNEL_LINUX
        default "liteos" if BR2_PACKAGE_HISILICON_KERNEL_LITEOS

source "package/hisilicon/kernel-module-adv7280m/Config.in"
source "package/hisilicon/kernel-module-hi_dbe/Config.in"
source "package/hisilicon/kernel-module-hi_osal/Config.in"
source "package/hisilicon/kernel-module-jaguar1/Config.in"
source "package/hisilicon/kernel-module-midgard/Config.in"
source "package/hisilicon/kernel-module-sysconfig/Config.in"
source "package/hisilicon/mali-lib/Config.in"
source "package/hisilicon/mpp-lib/Config.in"
source "package/hisilicon/reg-tools/Config.in"

endif
```

## package/hisilicon/hi3531-mpp-drv/Config.in
```kconfig
comment "hi3531-mpp-drv needs a Linux kernel to be built"
	depends on !BR2_LINUX_KERNEL

config BR2_PACKAGE_HI3531_MPP_DRV
	bool "hi3531-mpp-drv"
	depends on BR2_LINUX_KERNEL
	help
	  Kernel loadable module for Hi3531 MPP.
```

## package/hisilicon/kernel-module-adv7280m/Config.in
```kconfig
config BR2_PACKAGE_KERNEL_MODULE_ADV7280M
	bool "kernel-module-adv7280m"
	depends on BR2_LINUX_KERNEL
	help
	  Linux kernel driver for ADV7280M.
```

## package/hisilicon/kernel-module-hi_dbe/Config.in
```kconfig
config BR2_PACKAGE_KERNEL_MODULE_HI_DBE
	bool "kernel-module-hi_dbe"
	help
	  DMA Buffer Exporter for the Hi3XXX platforms.
```

## package/hisilicon/kernel-module-hi_osal/Config.in
```kconfig
config BR2_PACKAGE_KERNEL_MODULE_HI_OSAL
	bool "kernel-module-hi_osal"
	help
	  Operating System Abstract Layer for the Hi3XXX platforms.
```

## package/hisilicon/kernel-module-jaguar1/Config.in
```kconfig
config BR2_PACKAGE_KERNEL_MODULE_JAGUAR1
	bool "kernel-module-jaguar1"
	depends on BR2_LINUX_KERNEL
	help
	  Linux kernel driver for NVP6324.
```

## package/hisilicon/kernel-module-midgard/Config.in
```kconfig
config BR2_PACKAGE_KERNEL_MODULE_MIDGARD
	bool "kernel-module-midgard"
	help
	  Linux GPU driver the Hi3XXX platforms.
```

## package/hisilicon/kernel-module-sysconfig/Config.in
```kconfig
config BR2_PACKAGE_KERNEL_MODULE_SYSCONFIG
	bool "kernel-module-sysconfig"
	help
	  System configrations for the Hi3XXX platforms.
```

## package/hisilicon/mali-lib/Config.in
```kconfig
config BR2_PACKAGE_MALI_LIB
	bool "mali-lib"
	depends on (BR2_arm && BR2_ARM_EABIHF) || BR2_aarch64
	depends on BR2_TOOLCHAIN_USES_GLIBC
	select BR2_PACKAGE_HAS_LIBEGL
	select BR2_PACKAGE_HAS_LIBGLES
	select BR2_PACKAGE_HAS_LIBOPENCL
	help
	  ARM GPU userspace library for the Hi3XXX platforms.

if BR2_PACKAGE_MALI_LIB

config BR2_PACKAGE_PROVIDES_LIBEGL
	default "mali-lib"

config BR2_PACKAGE_PROVIDES_LIBGLES
	default "mali-lib"

config BR2_PACKAGE_PROVIDES_LIBOPENCL
	default "mali-lib"

endif
```

## package/hisilicon/mpp-ko/Config.in
```kconfig
comment "mpp-ko needs a Linux kernel to be built"
	depends on !BR2_LINUX_KERNEL

config BR2_PACKAGE_MPP_KO
	bool "mpp-ko"
	depends on BR2_LINUX_KERNEL
	depends on BR2_PACKAGE_HISILICON
	help
	  Kernel loadable module for Hi3516/Hi3531 MPP.
```
