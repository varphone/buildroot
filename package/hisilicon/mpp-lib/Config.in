## package/hisilicon/mpp-lib/Config.in
```kconfig
config BR2_PACKAGE_MPP_LIB
	bool "mpp-lib"
	help
	  Library of userspace and kernel drivers for the Hi3XXX platforms.
```

## package/hisilicon/reg-tools/Config.in
```kconfig
comment "reg-tools needs a Linux kernel to be built"
	depends on !BR2_LINUX_KERNEL

config BR2_PACKAGE_REG_TOOLS
	bool "reg-tools"
	depends on BR2_LINUX_KERNEL
	depends on BR2_PACKAGE_HISILICON
	help
	  Userspace register tools for Hi3516/Hi3531/Hi3520D.

config BR2_PACKAGE_REG_TOOLS_GPIO_I2C
	bool "Use GPIO I2C"
	depends on BR2_PACKAGE_REG_TOOLS

config BR2_PACKAGE_REG_TOOLS_CUSTOM_VERSION
	bool "Custom version"
	depends on BR2_PACKAGE_REG_TOOLS
	help
	  This option allows to use a specific official version from git.

config BR2_PACKAGE_REG_TOOLS_CUSTOM_VERSION_VALUE
	string "git tag version for reg-tools"
	default "1.0.0-Hi3531_SDK_V1.0.D.0"
	depends on BR2_PACKAGE_REG_TOOLS_CUSTOM_VERSION
	help
	  The version string does not include the prefix 'v'.
```

## package/incron/Config.in
```kconfig
config BR2_PACKAGE_INCRON
	bool "incron"
	help
	  This program is an "inotify cron" system.

	  http://inotify.aiken.cz
```

## package/libini/Config.in
```kconfig
config BR2_PACKAGE_LIBINI
	bool "libini"
	help
	  An INI file parser that can read, edit and create large INI files
```

## package/live555/Config.in
```kconfig
config BR2_PACKAGE_LIVE555
	bool "live555"
	depends on BR2_INSTALL_LIBSTDCPP
	help
	  LIVE555 Streaming Media forms a set of C++ libraries for multimedia
	  streaming, using open standard protocols (RTP/RTCP, RTSP, SIP).

	  http://www.live555.com/liveMedia/

config BR2_PACKAGE_LIVE555_CUSTOM_TARBALL
	bool "Custom tarball"
	depends on BR2_PACKAGE_LIVE555
	help
	  This option allows you to specify your own code package.

config BR2_PACKAGE_LIVE555_CUSTOM_TARBALL_LOCATION
	string "URL to custom tarbal"
	depends on BR2_PACKAGE_LIVE555_CUSTOM_TARBALL

config BR2_PACKAGE_LIVE555_CUSTOM_TARBALL_STRIP_COMPONENTS
	int "Strip components"
	default 0
	depends on BR2_PACKAGE_LIVE555_CUSTOM_TARBALL

config BR2_PACKAGE_LIVE555_FORCE_STATIC_LIBS
	bool "Force static libs"
	depends on BR2_PACKAGE_LIVE555
	help
	  Force build static libs, ignore the global settings.

comment "live555 needs a toolchain w/ C++"
	depends on !BR2_INSTALL_LIBSTDCPP
```

## package/lsscsi/Config.in
```kconfig
config BR2_PACKAGE_LSSCSI
	bool "lsscsi"
	help
	  The lsscsi command lists information about SCSI devices in Linux.

	  http://sg.danny.cz/scsi/lsscsi.html
```

## package/nginx-rtmp/Config.in
```kconfig
config BR2_PACKAGE_NGINX_RTMP
	bool "nginx-rtmp"
	depends on BR2_PACKAGE_NGINX_HTTP
	# uses pcre, so nginx needs to be built with pcre support
	select BR2_PACKAGE_PCRE
	help
	  NGINX-based Media Streaming Server.

	  https://github.com/varphone/nginx-rtmp-module
```

## package/qx1-firmware/Config.in
```kconfig
config BR2_PACKAGE_QX1_FIRMWARE
	bool "qx1-firmware"
	help
	  Firmware for the QX1 devices.

	  https://git.vaxpl.com/qx1-docs
```

## package/spdlog/Config.in
```kconfig
config BR2_PACKAGE_SPDLOG
	bool "spdlog"
	depends on BR2_INSTALL_LIBSTDCPP
	depends on BR2_TOOLCHAIN_HAS_SYNC_4
	help
	  Very fast, header only, C++ logging library.

	  https://github.com/gabime/spdlog/

comment "msgpack needs a toolchain w/ C++"
	depends on !BR2_INSTALL_LIBSTDCPP
	depends on BR2_TOOLCHAIN_HAS_SYNC_4
```

## package/tdc/Config.in
```kconfig
menuconfig BR2_PACKAGE_TDC
	bool "tdc packages"
	help
	  Those packages provide tdc devices supports.

if BR2_PACKAGE_TDC
source "package/tdc/radar-qt/Config.in"
endif
```

## package/tdc/aac-audio-lib/Config.in
```kconfig
config BR2_PACKAGE_AAC_AUDIO_LIB
	bool "aac-audio-lib"
	depends on BR2_arm
	depends on BR2_PACKAGE_TDC
	help
	  AAC Encoder/Decoder prebuild libraries for ARM, from Ambarella A5 BSP.
```

## package/tdc/cvr-mil-qt/Config.in
```kconfig
config BR2_PACKAGE_CVR_MIL_QT
	bool "cvr-mil-qt"
	depends on BR2_PACKAGE_TDC && BR2_PACKAGE_QT
	help
	  Car Video Recording System application for military devices.

config BR2_PACKAGE_CVR_MIL_QT_CUSTOM_VERSION
	bool "cvr-mil-qt custom version"
	depends on BR2_PACKAGE_CVR_MIL_QT
	help
	  This option allows to use a specific official version from git.

config BR2_PACKAGE_CVR_MIL_QT_CUSTOM_VERSION_VALUE
	string "cvr-mil-qt git tag version"
	default "1.3.0-CVR-MIL-V1"
	depends on BR2_PACKAGE_CVR_MIL_QT_CUSTOM_VERSION
```

## package/tdc/etlmd-ia-bgp/Config.in
```kconfig
config BR2_PACKAGE_ETLMD_IA_BGP
	bool "etlmd-ia-bgp"
	depends on BR2_PACKAGE_ETLMD_IA
	help
	  Background pusher for etlmd-ia.

config BR2_PACKAGE_ETLMD_IA_BGP_CUSTOM_VERSION
	bool "etlmd-ia-bgp custom version"
	depends on BR2_PACKAGE_ETLMD_IA_BGP
	help
	  This option allows to use a specific official version from git.

config BR2_PACKAGE_ETLMD_IA_BGP_CUSTOM_VERSION_VALUE
	string "etlmd-ia-ws git tag version"
	default "1.2"
	depends on BR2_PACKAGE_ETLMD_IA_BGP_CUSTOM_VERSION
```

## package/tdc/etlmd-ia-data/Config.in
```kconfig
config BR2_PACKAGE_ETLMD_IA_DATA
	bool "etlmd-ia-data"
	depends on BR2_PACKAGE_TDC
	depends on BR2_PACKAGE_ETLMD_IA
	help
	  Preferences and data for ETLMD.

config BR2_PACKAGE_ETLMD_IA_DATA_CUSTOM_VERSION
	bool "Custom version"
	depends on BR2_PACKAGE_ETLMD_IA_DATA
	help
	  This option allows to use a specific official version from git.

config BR2_PACKAGE_ETLMD_IA_DATA_CUSTOM_VERSION_VALUE
	string "git tag version for etlmd-ia-data"
	default "1.2"
	depends on BR2_PACKAGE_ETLMD_IA_DATA_CUSTOM_VERSION
```

## package/tdc/etlmd-ia-scripts/Config.in
```kconfig
config BR2_PACKAGE_ETLMD_IA_SCRIPTS
	bool "etlmd-ia-scripts"
	depends on BR2_PACKAGE_ETLMD_IA
	help
	  Scripts for etlmd-ia, like: etlmd-ia-pds, etlmd-ia-pv ...

config BR2_PACKAGE_ETLMD_IA_SCRIPTS_CUSTOM_VERSION
	bool "Custom version"
	depends on BR2_PACKAGE_ETLMD_IA_SCRIPTS
	help
	  This option allows to use a specific official version from git.

config BR2_PACKAGE_ETLMD_IA_SCRIPTS_CUSTOM_VERSION_VALUE
	string "git tag version for etlmd-ia-scripts"
	default "1.3"
	depends on BR2_PACKAGE_ETLMD_IA_SCRIPTS_CUSTOM_VERSION
```

## package/tdc/etlmd-ia-ws/Config.in
```kconfig
config BR2_PACKAGE_ETLMD_IA_WS
	bool "etlmd-ia-ws"
	depends on BR2_PACKAGE_ETLMD_IA
	help
	  Web Service based on expressjs for etlmd-ia.

config BR2_PACKAGE_ETLMD_IA_WS_CUSTOM_VERSION
	bool "etlmd-ia-ws custom version"
	depends on BR2_PACKAGE_ETLMD_IA_WS
	help
	  This option allows to use a specific official version from git.

config BR2_PACKAGE_ETLMD_IA_WS_CUSTOM_VERSION_VALUE
	string "etlmd-ia-ws git tag version"
	default "2.2"
	depends on BR2_PACKAGE_ETLMD_IA_WS_CUSTOM_VERSION
```

## package/tdc/etlmd-ia/Config.in
```kconfig
comment "etlmd-ia needs xpr"
	depends on !BR2_PACKAGE_XPR

config BR2_PACKAGE_ETLMD_IA
	bool "etlmd-ia"
	depends on BR2_PACKAGE_TDC
	help
	  Core application for ETLMD-V2.

config BR2_PACKAGE_ETLMD_IA_CUSTOM_VERSION
	bool "etlmd-ia custom version"
	depends on BR2_PACKAGE_ETLMD_IA
	help
	  This option allows to use a specific official version from git.

config BR2_PACKAGE_ETLMD_IA_CUSTOM_VERSION_VALUE
	string "etlmd-ia git tag version"
	default "2.0.2"
	depends on BR2_PACKAGE_ETLMD_IA_CUSTOM_VERSION
```

## package/tdc/gstvafilters/Config.in
```kconfig
comment "gstvafilters needs gstreamer1, gst1-plugins-base"
	depends on !BR2_PACKAGE_GSTREAMER1 || !BR2_PACKAGE_GST1_PLUGINS_BASE

config BR2_PACKAGE_GSTVAFILTERS
	bool "gstvafilters"
	depends on BR2_PACKAGE_TDC
	help
	  Video Analysis Filters for GStreamer 1.0.

config BR2_PACKAGE_GSTVAFILTERS_CUSTOM_VERSION
	bool "gstvafilters custom version"
	depends on BR2_PACKAGE_GSTVAFILTERS
	help
	  This option allows to use a specific official version from git.

config BR2_PACKAGE_GSTVAFILTERS_CUSTOM_VERSION_VALUE
	string "gstvafilters git tag version"
	default "1.0.0"
	depends on BR2_PACKAGE_GSTVAFILTERS_CUSTOM_VERSION
```

## package/tdc/hinvr-qt/Config.in
```kconfig
comment "hinvr-qt needs gstreamer1, qt"
	depends on !BR2_PACKAGE_GSTREAMER1 || !BR2_PACKAGE_QT

config BR2_PACKAGE_HINVR_QT
	bool "hinvr-qt"
	depends on BR2_PACKAGE_TDC
	help
	  Small NVR application for Hi35XX devices.

config BR2_PACKAGE_HINVR_QT_CUSTOM_VERSION
	bool "hinvr-qt custom version"
	depends on BR2_PACKAGE_HINVR_QT
	help
	  This option allows to use a specific official version from git.

config BR2_PACKAGE_HINVR_QT_CUSTOM_VERSION_VALUE
	string "hinvr-qt git tag version"
	default "1.0.0"
	depends on BR2_PACKAGE_HINVR_QT_CUSTOM_VERSION
```

## package/tdc/libavt/Config.in
```kconfig
config BR2_PACKAGE_LIBAVT
	bool "libavt"
	depends on BR2_PACKAGE_TDC
	help
	  AVT library for PPMD-V1.

config BR2_PACKAGE_LIBAVT_CUSTOM_VERSION
	bool "libavt custom version"
	depends on BR2_PACKAGE_LIBAVT
	help
	  This option allows to use a specific official version from git.

config BR2_PACKAGE_LIBAVT_CUSTOM_VERSION_VALUE
	string "libavt git tag version"
	default "1.0.3"
	depends on BR2_PACKAGE_LIBAVT_CUSTOM_VERSION
```

## package/tdc/libir370/Config.in
```kconfig
config BR2_PACKAGE_LIBIR370
	bool "libir370"
	depends on BR2_PACKAGE_TDC
	help
	  IR370 library for PPMD-V1.

config BR2_PACKAGE_LIBIR370_CUSTOM_VERSION
	bool "libir370 custom version"
	depends on BR2_PACKAGE_LIBIR370
	help
	  This option allows to use a specific official version from git.

config BR2_PACKAGE_LIBIR370_CUSTOM_VERSION_VALUE
	string "libir370 git tag version"
	default "1.0.4"
	depends on BR2_PACKAGE_LIBIR370_CUSTOM_VERSION
```

## package/tdc/libmal/Config.in
```kconfig
config BR2_PACKAGE_LIBMAL
	bool "libmal"
	depends on BR2_PACKAGE_TDC
	select BR2_PACKAGE_FREETYPE
	select BR2_PACKAGE_XPR
	help
	  Hi3XXX MPP midware library for PPMD-V1.

config BR2_PACKAGE_LIBMAL_CUSTOM_VERSION
	bool "libmal custom version"
	depends on BR2_PACKAGE_LIBMAL
	help
	  This option allows to use a specific official version from git.

config BR2_PACKAGE_LIBMAL_CUSTOM_VERSION_VALUE
	string "libmal git tag version"
	default "1.0.3"
	depends on BR2_PACKAGE_LIBMAL_CUSTOM_VERSION
```

## package/tdc/libpavo/Config.in
```kconfig
config BR2_PACKAGE_LIBPAVO
	bool "libpavo"
	depends on BR2_PACKAGE_TDC
	help
	  OpenGL ES 2.0/3.0 helper library.

config BR2_PACKAGE_LIBPAVO_CUSTOM_VERSION
	bool "libpavo custom version"
	depends on BR2_PACKAGE_LIBPAVO
	help
	  This option allows to use a specific official version from git.

config BR2_PACKAGE_LIBPAVO_CUSTOM_VERSION_VALUE
	string "libpavo git tag version"
	default "1.0.0"
	depends on BR2_PACKAGE_LIBPAVO_CUSTOM_VERSION
```

## package/tdc/libpes-legacy/Config.in
```kconfig
config BR2_PACKAGE_LIBPES_LEGACY
	bool "libpes-legacy"
	depends on BR2_PACKAGE_TDC
	help
	  Legacy XianDian MPEG2-PS library for TDC.

config BR2_PACKAGE_LIBPES_LEGACY_CUSTOM_VERSION
	bool "Custom version"
	depends on BR2_PACKAGE_LIBPES_LEGACY
	help
	  This option allows to use a specific official version from git.

config BR2_PACKAGE_LIBPES_LEGACY_CUSTOM_VERSION_VALUE
	string "git tag version for libpes-legacy"
	default "1.0"
	depends on BR2_PACKAGE_LIBPES_LEGACY_CUSTOM_VERSION
```

## package/tdc/libpwc/Config.in
```kconfig
config BR2_PACKAGE_LIBPWC
	bool "libpwc"
	depends on BR2_PACKAGE_TDC
	select BR2_PACKAGE_LIBMODBUS
	help
	  Serial Port library for PPMD-V1.

config BR2_PACKAGE_LIBPWC_CUSTOM_VERSION
	bool "libpwc custom version"
	depends on BR2_PACKAGE_LIBPWC
	help
	  This option allows to use a specific official version from git.

config BR2_PACKAGE_LIBPWC_CUSTOM_VERSION_VALUE
	string "libpwc git tag version"
	default "1.0.3"
	depends on BR2_PACKAGE_LIBPWC_CUSTOM_VERSION
```
