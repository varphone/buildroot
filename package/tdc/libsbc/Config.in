## package/tdc/libsbc/Config.in
```kconfig
config BR2_PACKAGE_LIBSBC
	bool "libsbc"
	depends on BR2_PACKAGE_TDC
	select BR2_PACKAGE_LIBMODBUS
	help
	  Solar Power Controller library for ETLMD-V2.

config BR2_PACKAGE_LIBSBC_CUSTOM_VERSION
	bool "libsbc custom version"
	depends on BR2_PACKAGE_LIBSBC
	help
	  This option allows to use a specific official version from git.

config BR2_PACKAGE_LIBSBC_CUSTOM_VERSION_VALUE
	string "libsbc git tag version"
	default "1.0.2"
	depends on BR2_PACKAGE_LIBSBC_CUSTOM_VERSION
```

## package/tdc/libserial-ppmd/Config.in
```kconfig
config BR2_PACKAGE_LIBSERIAL_PPMD
	bool "libserial-ppmd"
	depends on BR2_PACKAGE_TDC
	help
	  Serial Port library for PPMD-V1.

config BR2_PACKAGE_LIBSERIAL_PPMD_CUSTOM_VERSION
	bool "libserial-ppmd custom version"
	depends on BR2_PACKAGE_LIBSERIAL_PPMD
	help
	  This option allows to use a specific official version from git.

config BR2_PACKAGE_LIBSERIAL_PPMD_CUSTOM_VERSION_VALUE
	string "libserial-ppmd git tag version"
	default "1.0.2"
	depends on BR2_PACKAGE_LIBSERIAL_PPMD_CUSTOM_VERSION
```

## package/tdc/libstream-legacy/Config.in
```kconfig
config BR2_PACKAGE_LIBSTREAM_LEGACY
	bool "libstream-legacy"
	depends on BR2_PACKAGE_TDC
	help
	  Legacy XianDian Streamming library for TDC.

config BR2_PACKAGE_LIBSTREAM_LEGACY_CUSTOM_VERSION
	bool "Custom version"
	depends on BR2_PACKAGE_LIBSTREAM_LEGACY
	help
	  This option allows to use a specific official version from git.

config BR2_PACKAGE_LIBSTREAM_LEGACY_CUSTOM_VERSION_VALUE
	string "git tag version for libstream-legacy"
	default "1.0"
	depends on BR2_PACKAGE_LIBSTREAM_LEGACY_CUSTOM_VERSION
```

## package/tdc/libxd_muxer/Config.in
```kconfig
config BR2_PACKAGE_LIBXD_MUXER
	bool "libxd_muxer"
	depends on BR2_PACKAGE_TDC
	help
	  Legacy XianDian Media Muxing library for old system, like: Hi3531.

config BR2_PACKAGE_LIBXD_MUXER_CUSTOM_VERSION
	bool "libxd_muxer custom version"
	depends on BR2_PACKAGE_LIBXD_MUXER
	help
	  This option allows to use a specific official version from git.

config BR2_PACKAGE_LIBXD_MUXER_CUSTOM_VERSION_VALUE
	string "libxd_muxer git tag version"
	default "1.0.0"
	depends on BR2_PACKAGE_LIBXD_MUXER_CUSTOM_VERSION
```

## package/tdc/libxd_player/Config.in
```kconfig
config BR2_PACKAGE_LIBXD_PLAYER
	bool "libxd_player"
	depends on BR2_PACKAGE_TDC
	help
	  Legacy XianDian Media Playing library for old system, like: Hi3531.

config BR2_PACKAGE_LIBXD_PLAYER_CUSTOM_VERSION
	bool "libxd_player custom version"
	depends on BR2_PACKAGE_LIBXD_PLAYER
	help
	  This option allows to use a specific official version from git.

config BR2_PACKAGE_LIBXD_PLAYER_CUSTOM_VERSION_VALUE
	string "libxd_player git tag version"
	default "1.0.0"
	depends on BR2_PACKAGE_LIBXD_PLAYER_CUSTOM_VERSION
```

## package/tdc/libxd_stream/Config.in
```kconfig
config BR2_PACKAGE_LIBXD_STREAM
	bool "libxd_stream"
	depends on BR2_PACKAGE_TDC
	help
	  Legacy XianDian RTSP Streamming library for old system, like: Hi3531.

config BR2_PACKAGE_LIBXD_STREAM_CUSTOM_VERSION
	bool "libxd_stream custom version"
	depends on BR2_PACKAGE_LIBXD_STREAM
	help
	  This option allows to use a specific official version from git.

config BR2_PACKAGE_LIBXD_STREAM_CUSTOM_VERSION_VALUE
	string "libxd_stream git tag version"
	default "4.2.0"
	depends on BR2_PACKAGE_LIBXD_STREAM_CUSTOM_VERSION
```

## package/tdc/longan-hi3531/Config.in
```kconfig
comment "longan-hi3531 needs boost, mpp-lib, xpr"
	depends on !BR2_PACKAGE_BOOST || !BR2_PACKAGE_MPP_LIB || !BR2_PACKAGE_XPR

config BR2_PACKAGE_LONGAN_HI3531
	bool "longan-hi3531"
	depends on BR2_PACKAGE_TDC
	help
	  Longan Application built on Hi3531 platform.

config BR2_PACKAGE_LONGAN_HI3531_BUILD_EXAMPLES
	bool "build with examples"
	depends on BR2_PACKAGE_LONGAN_HI3531

config BR2_PACKAGE_LONGAN_HI3531_BUILD_TESTS
	bool "build with tests"
	depends on BR2_PACKAGE_LONGAN_HI3531

config BR2_PACKAGE_LONGAN_HI3531_TARGET
	string "hi3531 target board"
	default "longan"
	depends on BR2_PACKAGE_LONGAN_HI3531
	help
	  This option allows to specified the target board,
	  board availables: hivcap, hinvr, longan, ppmd

config BR2_PACKAGE_LONGAN_HI3531_CUSTOM_VERSION
	bool "longan-hi3531 custom version"
	depends on BR2_PACKAGE_LONGAN_HI3531
	help
	  This option allows to use a specific official version from git.

config BR2_PACKAGE_LONGAN_HI3531_CUSTOM_VERSION_VALUE
	string "longan-hi3531 git tag version"
	default "1.0.9"
	depends on BR2_PACKAGE_LONGAN_HI3531_CUSTOM_VERSION
```

## package/tdc/mpcam/Config.in
```kconfig
comment "mpcam needs opencv3"
	depends on !BR2_PACKAGE_OPENCV3

config BR2_PACKAGE_MPCAM
	bool "mpcam"
	depends on BR2_PACKAGE_TDC
	help
	  Multiple Path Camera Application built on Zynq-ZC702 platform.

config BR2_PACKAGE_MPCAM_BUILD_EXAMPLES
	bool "build with examples"
	depends on BR2_PACKAGE_MPCAM

config BR2_PACKAGE_MPCAM_BUILD_TESTS
	bool "build with tests"
	depends on BR2_PACKAGE_MPCAM

config BR2_PACKAGE_MPCAM_CUSTOM_VERSION
	bool "mpcam custom version"
	depends on BR2_PACKAGE_MPCAM
	help
	  This option allows to use a specific official version from git.

config BR2_PACKAGE_MPCAM_CUSTOM_VERSION_VALUE
	string "mpcam git tag version"
	default "1.0.0"
	depends on BR2_PACKAGE_MPCAM_CUSTOM_VERSION
```

## package/tdc/ppmd-3531/Config.in
```kconfig
comment "ppmd-3531 needs platform Hi3531"
	depends on BR2_PACKAGE_HISILICON_PLATFORM_HI3531

config BR2_PACKAGE_TDC_PPMD_3531
	bool "ppmd-3531"
	depends on BR2_PACKAGE_TDC
	select BR2_PACKAGE_TDC_XPR
	help
	  Core application for PPMD-V1.

config BR2_PACKAGE_TDC_PPMD_3531_VERSION
	string "version"
	default "1.0.0"
	depends on BR2_PACKAGE_TDC_PPMD_3531
	help
	  Tag version on git repo.
```

## package/tdc/radar-qt/Config.in
```kconfig
comment "radar-qt needs imx-lib, qt"
	depends on !BR2_PACKAGE_IMX_LIB || !BR2_PACKAGE_QT

config BR2_PACKAGE_RADAR_QT
	bool "radar-qt"
	depends on BR2_PACKAGE_TDC
	help
	  Radar application for 6A.

config BR2_PACKAGE_RADAR_QT_CUSTOM_VERSION
	bool "radar-qt custom version"
	depends on BR2_PACKAGE_RADAR_QT
	help
	  This option allows to use a specific official version from git.

config BR2_PACKAGE_RADAR_QT_CUSTOM_VERSION_VALUE
	string "radar-qt git tag version"
	default "1.0.0"
	depends on BR2_PACKAGE_RADAR_QT_CUSTOM_VERSION
```

## package/tdc/vrs-plugins/Config.in
```kconfig
config BR2_PACKAGE_VRS_PLUGINS
	bool "vrs-plugins"
	depends on BR2_PACKAGE_TDC
	help
	  Plugins for CVR-V1.

config BR2_PACKAGE_VRS_PLUGINS_CUSTOM_VERSION
	bool "vrs-plugins custom version"
	depends on BR2_PACKAGE_VRS_PLUGINS
	help
	  This option allows to use a specific official version from git.

config BR2_PACKAGE_VRS_PLUGINS_CUSTOM_VERSION_VALUE
	string "vrs-plugins git tag version"
	default "1.0.1"
	depends on BR2_PACKAGE_VRS_PLUGINS_CUSTOM_VERSION
```

## package/tdc/vrs-qt/Config.in
```kconfig
comment "vrs-qt needs mpp-lib, qt, xpr"
	depends on !BR2_PACKAGE_MPP_LIB || !BR2_PACKAGE_XPR || !BR2_PACKAGE_QT

config BR2_PACKAGE_VRS_QT
	bool "vrs-qt"
	depends on BR2_PACKAGE_TDC
	help
	  Video Recording System application for CVR-V1.

config BR2_PACKAGE_VRS_QT_CUSTOM_VERSION
	bool "vrs-qt custom version"
	depends on BR2_PACKAGE_VRS_QT
	help
	  This option allows to use a specific official version from git.

config BR2_PACKAGE_VRS_QT_CUSTOM_VERSION_VALUE
	string "vrs-qt git tag version"
	default "1.0.0"
	depends on BR2_PACKAGE_VRS_QT_CUSTOM_VERSION
```

## package/tdc/xpr-legacy/Config.in
```kconfig
config BR2_PACKAGE_XPR_LEGACY
	bool "xpr-legacy"
	depends on BR2_PACKAGE_TDC
	help
	  Legacy X Portable Runtime for TDC.

config BR2_PACKAGE_XPR_LEGACY_CUSTOM_VERSION
	bool "Custom version"
	depends on BR2_PACKAGE_XPR_LEGACY
	help
	  This option allows to use a specific official version from git.

config BR2_PACKAGE_XPR_LEGACY_CUSTOM_VERSION_VALUE
	string "git tag version for xpr-legacy"
	default "1.0-legacy"
	depends on BR2_PACKAGE_XPR_LEGACY_CUSTOM_VERSION
```

## package/tdc/xpr/Config.in
```kconfig
config BR2_PACKAGE_TDC_XPR
	bool "xpr"
	depends on BR2_PACKAGE_TDC
	help
	  X Portable Runtime for TDC.

config BR2_PACKAGE_TDC_XPR_VERSION
	string "version"
	default "2.0"
	depends on BR2_PACKAGE_TDC_XPR
	help
	  Tag version on git repo.
```

## package/tensen/Config.in
```kconfig
config BR2_PACKAGE_TENSEN
	bool "Tensen fonts"
	help
	  Parital of fonts from Tensentype.

	  http://www.tensentype.com

if BR2_PACKAGE_TENSEN

config BR2_PACKAGE_TENSEN_RUIHEIJ_W1
	bool "RuiHei - W1 fonts (Simplified)"
	default n

config BR2_PACKAGE_TENSEN_RUIHEIJ_W2
	bool "RuiHei - W2 fonts (Simplified)"
	default y

config BR2_PACKAGE_TENSEN_XIHEIJ
	bool "XiHei fonts (Simplified)"
	default n

config BR2_PACKAGE_TENSEN_XINYUANJ_W1
	bool "XinYuan - W1 fonts (Simplified)"
	default n

config BR2_PACKAGE_TENSEN_ZHIHEIJ_W2
	bool "ZhiHei - W2 fonts (Simplified)"
	default n

config BR2_PACKAGE_TENSEN_ZHIHEIJ_W3
	bool "ZhiHei - W3 fonts (Simplified)"
	default n

config BR2_PACKAGE_TENSEN_ZHONGHEIJ
	bool "ZhongHei fonts (Simplified)"
	default n

config BR2_PACKAGE_TENSEN_ZHONGYUANJ
	bool "ZhongYuan fonts (Simplified)"
	default n

endif
```

## package/zylaser-firmware/Config.in
```kconfig
config BR2_PACKAGE_ZYLASER_FIRMWARE
	bool "zylaser-firmware"
	help
	  This package provides various binary firmware files (closed
	  binary blobs) for zylaser like FSBL, FPGA etc.
```
